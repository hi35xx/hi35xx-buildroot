## linux/linux-3.4.y/drivers/mtd/nand/hinfc504/Kconfig
```kconfig
#
# drivers/mtd/nand/hinfc504/Kconfig
# add by caizhiyong 2010.11.04
#

menuconfig MTD_NAND_HINFC504
	tristate "Hisilicon NAND Controller v504 device Support"
	depends on MTD_NAND
	default y if (ARCH_HI3535)
	select YAFFS_FS
	select MISC_FILESYSTEMS
	select MTD_BLOCK
	select YAFFS_YAFFS2
	help
	  Hisilicon NAND Controller v504 device Support

if MTD_NAND_HINFC504

config HINFC504_REG_BASE_ADDRESS
	hex "nand controller's register base address"
	default 0x10000000 if (ARCH_HI3535)
	help
	  register base address of nand controller

config HINFC504_BUFFER_BASE_ADDRESS
	hex "nand controller's buffer base address"
	default 0x50000000 if (ARCH_HI3535)
	help
	  buffer base address of nand controller

config HINFC504_PERIPHERY_REGBASE
	hex "nand controller's peripher base address"
	default 0x20030000 if (ARCH_HI3535)
	help
	  peripher base address of nand controller,for clk setting

config HINFC504_MAX_CHIP
	int "number of nand flash chip (1,4)"
	default 1
	help
	  nand controller v504 device only support 1 or 2 nand flash chip,
	  your should not config other value.

config HINFC504_DBG_NAND_PROC_FILE
	bool "Debug: create /proc/nand_logs file"
	help
	  Create /proc/nand_logs file for debug.

config HINFC504_DBG_NAND_PE_PROC_FILE
	bool "Debug: create /proc/nand_erase file"
	help
	  Create /proc/nand_erase file record nand erase times for every block.

config HINFC504_DBG_NAND_EC_NOTICE
	bool "Debug: notice uncorrectable error"
	help
	  Notice nand uncorrectable error

choice
	prompt "Pagesize and Ecc Type Select"

config HINFC504_HARDWARE_PAGESIZE_ECC
	bool "Hardware"
	help
	  pagesize and ecc type use hardware config

config HINFC504_AUTO_PAGESIZE_ECC
	bool "Auto"
	help
	  pagesize and ecc type use hardware config

config HINFC504_PAGESIZE_AUTO_ECC_NONE
	bool "Pagesize Auto, Ecc None"
	help
	  select pagesize 2K, ecc none.

endchoice

endif # MTD_NAND_HINFC504
```

## linux/linux-3.4.y/drivers/mtd/nand/hinfc610/Kconfig
```kconfig
#
# drivers/mtd/nand/hinfc610/Kconfig
# add by caizhiyong 2010.11.04
#

menuconfig MTD_NAND_HINFC610
	tristate "Hisilicon NAND Controller v610 device Support"
	depends on MTD_NAND
	default y if (ARCH_HI3516A)
	select YAFFS_FS
	select MISC_FILESYSTEMS
	select MTD_BLOCK
	select YAFFS_YAFFS2
	help
	  When the config is set, the kernel will support Hisilicon
	  NAND Controller v610 device. It means that the kernel would
	  control the nand flash with the nand controller v610 device
	  in operation.

if MTD_NAND_HINFC610

config HINFC610_REG_BASE_ADDRESS
	hex "nand controller's register base address"
	default 0x10000000 if (ARCH_HI3516A)
	help
	  register base address of nand controller

config HINFC610_BUFFER_BASE_ADDRESS
	hex "nand controller's buffer base address"
	default 0x50000000 if (ARCH_HI3516A)
	help
	  buffer base address of nand controller

config HINFC610_PERIPHERY_REGBASE
	hex "nand controller's peripher base address"
	default 0x20030000 if (ARCH_HI3516A)
	help
	  peripher base address of nand controller,for clk setting

config HINFC610_MAX_CHIP
	int "number of nand flash chip (1,4)"
	default 1
	help
	  nand controller v610 device only support 1 or 2 nand flash chip,
	  your should not config other value.

config HINFC610_DBG_NAND_DEBUG
	bool "Debug: create debug file to control debug type"
	default y
	help
	  When the config is set, the kernel will add the "debug" file
	  to control debug type. When the config is set, we could choose
	  the debugging type to display the informations of the nand controller
	  v610 device in operation.

config HINFC610_DBG_NAND_DUMP
	bool "Debug: display read/write/erase process nand data"
	depends on HINFC610_DBG_NAND_DEBUG
	default y
	help
	  When the config is set, the kernel will add "dump" file to
	  display all nand operation and data.When the "HINFC610_DBG_NAND_DEBUG"
	  has been set, the nand controller v610 device will display
	  all the operations and data.

config HINFC610_DBG_NAND_ERASE_COUNT
	bool "Debug: display last erase count"
	depends on HINFC610_DBG_NAND_DEBUG
	default y
	help
	  When the config is set, the kernel will add "erase_count" file
	  to display last erase count. When the "HINFC610_DBG_NAND_DEBUG"
	  has been set, the nand controller v610 device will display
	  the last erase count.

config HINFC610_DBG_NAND_ECC_COUNT
	bool "Debug: display last ecc count."
	depends on HINFC610_DBG_NAND_DEBUG
	default y
	help
	  When the config is set, the kernel will add "ecc_count"
	  to display last ecc count. When the "HINFC610_DBG_NAND_DEBUG"
	  has been set, the nand controller v610 device will display
	  the last ecc count.

config HINFC610_DBG_NAND_READ_RETRY
	bool "Debug: display read_retry process"
	depends on HINFC610_DBG_NAND_DEBUG
	default y
	help
	  When the config is set, the kernel will add read_retry file
	  to display read_retry process.

choice
	prompt "Pagesize and Ecc Type Select"

config HINFC610_AUTO_PAGESIZE_ECC
	bool "Auto"
	help
	  When the config is set, pagesize and ecc type will use
	  hardware config. When we replace the flash, the
	  controller will identify the pagesize and ecc type of
	  the flash.

config HINFC610_PAGESIZE_AUTO_ECC_NONE
	bool "Pagesize Auto, Ecc None"
	help
	  select pagesize 2K, ecc none.

endchoice

endif # MTD_NAND_HINFC610
```

## linux/linux-3.4.y/drivers/mtd/nand/hisnfc100/Kconfig
```kconfig
#
# drivers/mtd/nand/hisnfc100/Kconfig
# add by hisilicon 2014.2.24
#

menuconfig MTD_NAND_HISNFC100
	tristate "Hisilicon SPI Nand Controller v100 device Support"
	depends on MTD_NAND
	default y if (ARCH_HI3516A)
	select YAFFS_FS
	select MISC_FILESYSTEMS
	select MTD_BLOCK
	select YAFFS_YAFFS2
	help
	  Hisilicon SPI Nand Controller version 100 is called HISNFC100 for
	  short. The controller support registers and DMA transfers while
	  reading or writing the spi nand flash.

if MTD_NAND_HISNFC100

config HISNFC100_REG_BASE_ADDRESS
	hex "spi nand controller's register base address"
	default 0x10040000 if (ARCH_HI3516A)
	help
	  register base address of spi nand controller

config HISNFC100_BUFFER_BASE_ADDRESS
	hex "spi nand controller's buffer base address"
	default 0x54000000 if (ARCH_HI3516A)
	help
	  buffer base address of spi nand controller

config HISNFC100_MAX_CHIP
	int "number of spi nand flash chip (1, 2)"
	default 1
	help
	  spi nand controller v100 device only support 1 or 2 spi nand
	  flash chip, your should not config other value.

choice
	prompt "Pagesize and Ecc Type Select"

config HISNFC100_HARDWARE_PAGESIZE_ECC
	bool "Hardware"
	help
	  the configure of page size and ecc type lie on switch
	  on the board.
	  so the page size and ecc type is controlled by Hardware
	  see demo board of SOC.

config HISNFC100_AUTO_PAGESIZE_ECC
	bool "Auto"
	help
	  auto-sensed the page size and ecc type value. driver will
	  try each of page size and ecc type one by one till flash
	  can be read and wrote accurately.
	  so the page size and ecc type is match adaptively without
	  switch on the board

config HISNFC100_PAGESIZE_AUTO_ECC_NONE
	bool "Pagesize Auto, Ecc None"
	help
	  select pagesize 2K, ecc none.

endchoice

endif # MTD_NAND_HISNFC100
```

## linux/linux-3.4.y/drivers/net/ethernet/hieth-gmac/Kconfig
```kconfig
#
# higmac family network device configuration
#

menuconfig HIETH_GMAC
	tristate "hieth gmac family network device support"
	depends on ARCH_HI3516A
	default y
	help
	  This selects the hieth gmac family network device. The gigabit
	  switch fabric (GSF) receives and transmits data over two Ethernet
	  ports at 10/100/1000 Mbit/s in full-duplex or half-duplex mode.
	  The Ethernet port exchanges data with the CPU port, and supports
	  the energy efficient Ethernet (EEE) and wake on LAN (WoL) functions.

if HIETH_GMAC

config HIETH_TAG
	hex "hieth-gmac misc tag"
	default "0x544100ff"
	help
	  This is graceful set phy interface/mdio/phyaddr in kernel.

config ETHADDR_TAG
	hex "hieth-gmac mac address tag"
	default "0x726d6d73"
	help
	  This is graceful set mac address in kernel.

config HIGMAC_IOBASE
	hex "hieth-gmac IO address"
	default "0x10090000" if ARCH_HI3516A

config HIGMAC_IRQNUM
	int "hieth-gmac irq number"
	default "57" if ARCH_HI3516A

config HIGMAC_PHY0_ADDR
	int "hieth-gmac phy0 addr"
	range 1 31
	default "1"
	help
	  mac0's phy addr.


config HIGMAC_PHY0_INTERFACE_MODE
	int "hieth-gmac phy0 interface mode"
	range 1 6
	default "6"
	 help
	  hieth-gmac phy0 interface mode.
	  1---MII,
	  5---RMII,
	  6---RGMII.
config HIGMAC_RESET_HELPER_EN
	bool "higmac reset helper"
	default y
	default n if ARCH_HI3516A
	help
	  hieth phy reset gpio helper.
	  some external phy need to be reset before use, so we
	  use gpio to reset it.

config HIGMAC_RESET_HELPER_GPIO_BASE
	hex "higmac reset helper on which gpio group"
	depends on HIGMAC_RESET_HELPER_EN
	default "0x20140000" if ARCH_HI3516A
	help
	  higmac gpio group for reset.

config HIGMAC_RESET_HELPER_GPIO_BIT
	int "higmac reset helper on gpio bit"
	depends on HIGMAC_RESET_HELPER_EN
	range 0 7
	default "1" if ARCH_HI3516A
	help
	  higmac gpio group bit for reset.

config HIGMAC_RESET_HELPER_GPIO_VALUE
	int "higmac reset helper on gpio value"
	depends on HIGMAC_RESET_HELPER_EN
	range 0 1
	default "0" if ARCH_HI3516A
	help
	  higmac gpio reset value.

config RX_FLOW_CTRL_SUPPORT
        bool "rx flow ctrl supported"
        default y
        help
          Rx flow ctrl supported, default is enabled.
	  When we received pause frame,
          we will stop transmiting data frame for some time.
	  The stopping time is the time filled in pause frame.

config TX_FLOW_CTRL_SUPPORT
        bool "tx flow ctrl supported"
        default y
        help
          Tx flow ctrl supported, default is enabled.
          When we has no buffer to receive packet,
          we will send pause frame.
	  When buffer is avaliable, we will send zero-quanta pause frame.

config TX_FLOW_CTRL_PAUSE_TIME
        hex "tx flow ctrl pause time"
        default "0xFFFF"
        help
          The pause time filled in the sending pause frame.
	  The unit is the time for transmiting 512 bit data.
	  This value is 16 bit, so its value is 0x0000~0xFFFF.
	  The default value is 0xFFFF.

config TX_FLOW_CTRL_PAUSE_INTERVAL
        hex "tx flow ctrl pause interval"
        default "0xFFFF"
        help
          The interval time for sending pause frame.
	  When the remainint amount of receive queue is below tx flow ctrl active threshold,
	  we will wait this time to transmiting pause frame.
	  The unit is the time for transmiting 512 bit data.
	  This value is 16 bit, so its value is 0x0000~0xFFFF.
	  The default value is 0xFFFF.


config TX_FLOW_CTRL_ACTIVE_THRESHOLD
        int "tx flow ctrl active threshold"
        default "16"
        range 1 127
        help
          The threshold for activing tx flow ctrl.
          When the left amount of receive queue descriptors is below this threshold,
          hardware will send pause frame immediately.
          We advise this value is set smaller than 64. Too bigger is not a good choice.
          This value must be smaller than tx flow ctrl deactive threshold.

config TX_FLOW_CTRL_DEACTIVE_THRESHOLD
        int "tx flow ctrl deactive threshold"
        default "32"
        range 1 127
        help
          The threshold for deactiving tx flow ctrl.
          When the left amount of receive queue descriptors is above or equal with this threshold,
          hardware will exit flow control state.
          We advise this value is set smaller than 64. Too bigger is not a good choice.
          This value must be larger than tx flow ctrl active threshold.

endif # HIETH_GMAC
```
