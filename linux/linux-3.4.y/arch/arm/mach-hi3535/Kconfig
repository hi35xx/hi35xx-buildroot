## package/himpp/himpp-hi3518v200/Config.in
```kconfig
comment "Options for hi3518v200 mpp"

config BR2_PACKAGE_HIMPP_PREFIX
	string "Install prefix"
	default "/usr"
	help
	  Prefix to install himpp on the target file system.

choice
	bool "SDK Version"
	default BR2_PACKAGE_HIMPP_HI3518V200_SDK_V1_0_4_0

config BR2_PACKAGE_HIMPP_HI3518V200_SDK_V1_0_2_0
	bool "1.0.2.0"

config BR2_PACKAGE_HIMPP_HI3518V200_SDK_V1_0_3_0
	bool "1.0.3.0"

config BR2_PACKAGE_HIMPP_HI3518V200_SDK_V1_0_4_0
	bool "1.0.4.0"

endchoice

config BR2_PACKAGE_HIMPP_HI3518V200_SDK_VERSION
	string
	default "1.0.2.0" if BR2_PACKAGE_HIMPP_HI3518V200_SDK_V1_0_2_0
	default "1.0.3.0" if BR2_PACKAGE_HIMPP_HI3518V200_SDK_V1_0_3_0
	default "1.0.4.0" if BR2_PACKAGE_HIMPP_HI3518V200_SDK_V1_0_4_0
```
