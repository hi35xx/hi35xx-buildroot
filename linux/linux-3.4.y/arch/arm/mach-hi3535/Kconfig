## linux/linux-3.4.y/arch/arm/mach-hi3535/Kconfig
```kconfig
menu "HI3535 board feature"

config MACH_HI3535
	bool "Support hi3535 platform"
	select CPU_V7
	select ARM_GIC
	select ARM_TIMER_SP804
	help
	  Include support for the hisilion HI3535 platform.
	  HI3535 support ARM CORTEX-A9 processer,
	  within a Generic Interrupt Controller.
	  Support DDR2 and DDR3.
choice
        prompt "CPU timer source"
        default HAVE_SP804_LOCAL_TIMER

config HAVE_SP804_LOCAL_TIMER
	bool "arm local timer from sp804"
	help
	  arm local timer from sp804.
	  if you choice sp804 as local timer,
	  please select HAVE_SP804_LOCAL_TIMER,
	  if you choice arm selt as local timer,
	  please select HAVE_ARM_LOCAL_TIMER.

config HAVE_ARM_LOCAL_TIMER
	bool "arm local timer from arm self"
	help
	  arm local timer from arm self.
	  if you choice sp804 as local timer,
	  please select HAVE_SP804_LOCAL_TIMER,
	  if you choice arm selt as local timer,
	  please select HAVE_ARM_LOCAL_TIMER.

endchoice

config DEFAULT_BUSCLK
	int "DEFAULT_BUSCLK"
	default "50000000"
	help
	  Default AHB clock rate


endmenu
```

## linux/linux-3.4.y/drivers/ata/Kconfig.ahci
```kconfig
#
# hisilicon sata ahci device configuration
#

menuconfig HI_SATA
	bool "hisilicon sata device support"
	depends on ARCH_HI3535
	default y if ARCH_HI3535
	select ATA
	select ATA_VERBOSE_ERROR
	select SATA_PMP
	help
	  This selects the hisilicon sata device.
	  We have two logic IP for our chip.
	  First is SATA 2.0 supporting 1.5G/3G.
	  Second is SATA 3.0 supporting 1.5G/3G/6G.

if HI_SATA

config HI_SATA_V100
	bool "hisilicon sata device V100"
	default n
	help
	  Use hisilicon sata v100 logic set y here.
	  set n for HI_SATA_V200.
	  hisilicon sata v100 logic is sata 2.0.
	  support 1.5G/3G mode.

config HI_SATA_V200
	bool "hisilicon sata device V200"
	depends on ARCH_HI3535
	default y if ARCH_HI3535
	help
	  Use hisilicon sata v200 logic set y here.
	  set n for HI_SATA_V100.
	  hisilicon sata v200 logic is sata 3.0.
	  support 1.5G/3G/6G mode.

config HI_SATA_IOBASE
	hex "hi sata IO address"
	default "0x12010000" if ARCH_HI3535

config HI_SATA_IOSIZE
	hex "hi sata IO size"
	default "0x00010000"
	help
	  default is 0x10000.

config HI_SATA_IRQNUM
	int "hi sata irq number"
	default "63" if ARCH_HI3535

config HI_SATA_PORTS
	int "hi sata port number"
	range 1 2
	default "2" if ARCH_HI3535
	help
	  Hi3535 have two SATA ports and one eSATA port.

config HI_SATA_MODE
	int "hi sata interworking speed mode(1.5G:0/3G:1/6G:2)"
	range 0 2
	default "1" if ARCH_HI3535

config PX_TX_AMPLITUDE
	hex "hi sata px_tx_amplitude"
	default 0x00376eb8
	help
	  This value is about the signal quality.
	  If there are some HDs can not be recognized,
	  try to change this value.

config PX_TX_PREEMPH
	hex "hi sata px_tx_preemph"
	default 0x0000a280
	help
	  This value is about the signal quality.
	  If there are some HDs can not be recognized,
	  try to change this value.

config HI_SATA_FBS
	int "hi sata FIS-Based switching"
	default 1
	range 0 1
	help
	  Hisatav200 supports FBS.
	  FBS is FIS-Based switching.
	  Choose y if you want to use it.

config HI_SATA_NCQ
	int "hi sata Native Command Queuing"
	default 1
	range 0 1
	help
	  Hisatav200 supports NCQ.
	  NCQ is Native Command Queuing.
	  Choose y if you want to use it.

endif # HI_SATA

#vim: set ts=8 sw=8 tw=78:
```

## linux/linux-3.4.y/drivers/hidmac/Kconfig
```kconfig
#
# Sensor device configuration
#

config HI_DMAC
	tristate "Hisilicon DMAC Controller support"
	depends on (ARCH_HI3516A || ARCH_HI3518EV200)
	help
	  Hisilicon I2C controller has 3 buses.
	  We can access some sensors though it.
	  This IP is only used in HI3516A and
	  HI3518EV200 chip.

if HI_DMAC
config HI_DMAC_IO_BASE
	hex "hi dmac register base address"
	default "0x10060000" if ARCH_HI3516A
	default "0x10060000" if ARCH_HI3518EV200

config HI_DMAC_CHANNEL_NUM
	int "hi dmac channel num"
	default "4" if ARCH_HI3516A
	default "4" if ARCH_HI3518EV200
endif
```

## linux/linux-3.4.y/drivers/mmc/host/himci/Kconfig
```kconfig
#
#  himci family SD/MMC device configuration
#
menuconfig HIMCI
	tristate "himciv100 driver support"
	depends on ARCH_HI3516A
	default y if ARCH_HI3516A
	select MMC_UNSAFE_RESUME
	select MMC_EMBEDDED_SDIO
	select MMC_BLOCK
	select MMC_BLOCK_BOUNCE
	help
	  This selects the Hisilicon Synopsys MultiMedia Card Driver
	  support. If you want use SD/MMC/SDIO driver,
	  Say Y or M here.

	  default is Y.

config SEND_AUTO_STOP
	bool "Send Auto Stop to terminate data transfer between host and SD card"
	depends on ARCH_HI3516A && HIMCI
	default y

menuconfig HIMCI0
	bool "himci0 sd/mmc controller support"
	depends on ARCH_HI3516A && HIMCI
	default y if ARCH_HI3516A
	help
	  This selects the Hisilicon Synopsys MultiMedia Card Interface
	  support. If you have a mmc platform with a MultiMedia Card slot,
	  Say Y here or cancel the choice.

	  default is Y.

if HIMCI0

config HIMCI0_IOBASE
	hex "himci0 reg base"
	default "0x206e0000" if ARCH_HI3516A

config HIMCI0_INTR
	int "himci0 intr number"
	default "51" if ARCH_HI3516A

config MMC0_CLK
	int "himci0 mmc clock"
	default "50000000" if ARCH_HI3516A

config MMC0_CCLK_MAX
	int "himci0 mmc c-clock max"
	default "50000000" if ARCH_HI3516A

config MMC0_CCLK_MIN
	int "himci0 mmc c-clock min"
	default "60000"

endif

menuconfig HIMCI1
	bool "himci1 sd/mmc controller support"
	depends on ARCH_HI3516A && HIMCI
	default y if ARCH_HI3516A
	help
	  This selects the Hisilicon Synopsys MultiMedia Card Interface
	  support. If you have a mmc platform with a MultiMedia Card slot,
	  Say Y or cancel the choice.

	  default is Y.

if HIMCI1

config HIMCI1_IOBASE
	hex "himci1 reg base"
	default "0x206f0000" if ARCH_HI3516A

config HIMCI1_INTR
	int "himci1 intr number"
	default "52" if ARCH_HI3516A

config MMC1_CLK
	int "himci1 mmc clock"
	default "100000000" if ARCH_HI3516A

config MMC1_CCLK_MAX
	int "himci1 mmc c-clock max"
	default "100000000" if ARCH_HI3516A

config MMC1_CCLK_MIN
	int "himci1 mmc c-clock min"
	default "60000"

endif
```

## linux/linux-3.4.y/drivers/mmc/host/himciv200/Kconfig
```kconfig
#
# himci v200 device configuration
#
menuconfig HIMCIV200
	tristate "himci v200 eMMC/SDXC/SDIO device support"
	depends on (ARCH_HI3518EV200)
	default y if (ARCH_HI3518EV200)
	select MMC_UNSAFE_RESUME
	select MMC_EMBEDDED_SDIO
	select MMC_BLOCK
	select MMC_BLOCK_BOUNCE
	help
	  This selects the Hisilicon Synopsys MultiMedia Card Driver
	  support. If you want use SD/MMC/SDIO driver,
	  Say Y or M here.

	  default is Y.

config SEND_AUTO_STOP
	bool "Send Auto Stop to terminate data transfer between host and SD card"
	depends on ((ARCH_HI3536 || ARCH_HI3518EV200) && HIMCIV200)
	default y

menuconfig HIMCIV200_SDIO0
	bool "himci0 emmc/sdxc/mmc controller support"
	depends on (ARCH_HI3518EV200 && HIMCIV200)
	default y if (ARCH_HI3518EV200)
	help
	  This selects the Hisilicon Synopsys MultiMedia Card Interface
	  support. If you have a mmc platform with a MultiMedia Card slot,
	  Say Y here or cancel the choice.

	  default is Y.

if HIMCIV200_SDIO0

config HIMCIV200_SDIO0_IOBASE
	hex "himci v200 sdio0 reg base"
	default "0x10020000" if (ARCH_HI3518EV200)

config HIMCIV200_SDIO0_INTR
	int "himci v200 sdio0 intr number"
	default "18" if (ARCH_HI3518EV200)

config HIMCIV200_SDIO0_BUS_WIDTH_8
	bool "himci v200 sdio0 bus_width_8_bit support"
	default n if (ARCH_HI3518EV200)
	help
	  This config is used to enable or disable the
	  8 bit width sdio0 bus, if set this value to n,
	  disable the support of 8 bit width sdio0 bus;
	  otherwise, enable the support of 8 bit width
	  sdio0 bus.

config HIMCIV200_SDIO0_CLK
	int "himci v200 mmc clock"
	default "99000000" if (ARCH_HI3518EV200)

config HIMCIV200_SDIO0_CLK_MAX
	int "himci v200 mmc c-clock max"
	default "99000000" if (ARCH_HI3518EV200)

config HIMCIV200_SDIO0_CLK_MIN
	int "himci v200 mmc c-clock min"
	default "60000"

config HIMCIV200_READ_ONLY
	bool "himci v200 partition read only"
	default n

endif
menuconfig HIMCIV200_SDIO1
	bool "himci1 sd/mmc controller support"
	depends on (ARCH_HI3518EV200 && HIMCIV200)
	default y if (ARCH_HI3518EV200)
	help
	  This selects the Hisilicon Synopsys MultiMedia Card Interface
	  support. If you have a mmc platform with a MultiMedia Card slot,
	  Say Y or cancel the choice.

	  default is Y.

if HIMCIV200_SDIO1


config HIMCIV200_SDIO1_IOBASE
	hex "himci v200 sdio1 reg base"
	default "0x10030000" if (ARCH_HI3518EV200)

config HIMCIV200_SDIO1_INTR
	int "himci v200 sdio1 intr number"
	default "8" if (ARCH_HI3518EV200)

config HIMCIV200_SDIO1_BUS_WIDTH_8
	bool "himci v200 sdio1 bus_width_8_bit support"
	default n if (ARCH_HI3518EV200)
	help
	  This config is used to enable or disable the
	  8 bit width sdio1 bus, if set this value to n,
	  disable the support of 8 bit width sdio1 bus;
	  otherwise, enable the support of 8 bit width
	  sdio1 bus.

config HIMCIV200_SDIO1_CLK
	int "himci v200 mmc clock"
	default "49500000" if (ARCH_HI3518EV200)

config HIMCIV200_SDIO1_CLK_MAX
	int "himci v200 mmc c-clock max"
	default "49500000" if (ARCH_HI3518EV200)

config HIMCIV200_SDIO1_CLK_MIN
	int "himci v200 mmc c-clock min"
	default "60000"

config HIMCIV200_READ_ONLY
	bool "himci v200 partition read only"
	default n

endif
```

## linux/linux-3.4.y/drivers/mtd/devices/hifmc100/Kconfig
```kconfig
#
# hisilicon flash memory controller SPI nor device driver version 100
# drivers/mtd/devices/hifmc100_spi_nor/Kconfig
# add by hisilicon 2014.10.9
#

menuconfig HIFMC100_SPI_NOR
	tristate "Hisilicon Flash Memory Controller v100 SPI Nor flash Support"
	depends on HIFMC
	depends on HIFMC_SPI_NOR
	default y if ARCH_HI3518EV200
	help
	  Hisilicon Flash Memory Controller device version 100 driver Support
	  Hisilicon Flash Memory Controller version 100 is called hifmc100 for
	  short. The controller driver support registers and DMA transfers
	  while reading or writing the SPI nor flash.

if HIFMC100_SPI_NOR

config SPI_NOR_MAX_CHIP_NUM
	int "Support max number of SPI Nor flash chip (1, 2)"
	default 1 if ARCH_HI3518EV200
	help
	  flash memory controller v100 device only support 1 or 2 SPI nor flash
	  chip, your should not config other value.

config SPI_BLOCK_PROTECT
	bool "Spi Nor Device BP(Block Protect) Support"
	default y if ARCH_HI3518EV200
	help
	  Hifmcv100 supports BP(Block Protect) feature to preestablish a series
	  area to avoid writing and erasing, except to reading. With this macro
	  definition we can get the BP info which was setted before. The
	  BOTTOM/TOP bit is setted to BOTTOM, it means the lock area starts
	  from 0 address.

config CLOSE_SPI_8PIN_4IO
	bool "Close SPI device Quad SPI mode for some 8PIN chip"
	default y if ARCH_HI3518EV200
	help
	  Hifmcv100 support Quad SPI mode and Quad&addr SPI mode.
	  But some 8PIN chip does not support this mode when HOLD/IO3 PIN was used
	  by reset operation. Usually, your should not config this option.

endif # End of HIFMC100_SPI_NOR
```

## linux/linux-3.4.y/drivers/mtd/devices/hisfc350/Kconfig
```kconfig
#
# hisilicon spi flash controller device version 350
#

menuconfig MTD_HISFC350
	tristate "hisilicon spi flash controller device version 350 driver"
	depends on (ARCH_GODSMART || ARCH_PHOENIX || ARCH_HI3518 || ARCH_HI3535 || ARCH_HI3520D || ARCH_HI3516A)
	default y if (ARCH_GODSMART || ARCH_PHOENIX || ARCH_HI3518 || ARCH_HI3535 || ARCH_HI3520D || ARCH_HI3516A)
	select MTD_SPI_IDS
	help
	  Hisilicon spi flash controller device version 350.
	  Hisilicon spi flash controller version 350 support
	  DMA transfers while reading and write the spi flash,
	  which will improve the performace very much.

if MTD_HISFC350

config HISFC350_SYSCTRL_ADDRESS
	hex "cpu system control register base address"
	default "0x101e0000" if ARCH_GODSMART
	default "0x200d0000" if ARCH_PHOENIX
	default "0x20030000" if (ARCH_HI3518 || ARCH_HI3535 || ARCH_HI3520D || ARCH_HI3516A)

config HISFC350_BUFFER_BASE_ADDRESS
	hex "hisfc350 read/write memory base address"
	default "0x30000000" if ARCH_GODSMART
	default "0x58000000" if ARCH_PHOENIX
	default "0x58000000" if (ARCH_HI3518 || ARCH_HI3535 || ARCH_HI3520D || ARCH_HI3516A)

config HISFC350_REG_BASE_ADDRESS
	hex "hisfc350 register base address"
	default "0x10130000" if ARCH_GODSMART
	default "0x20020000" if ARCH_PHOENIX
	default "0x10010000" if (ARCH_HI3518 || ARCH_HI3535 || ARCH_HI3520D || ARCH_HI3516A)

config HISFC350_CHIP_NUM
	int "hisfc350 spi chip number"
	default 2 if ARCH_GODSMART
	default 2 if ARCH_PHOENIX
	default 2 if (ARCH_HI3518 || ARCH_HI3535 || ARCH_HI3520D || ARCH_HI3516A)

config HISFC350_SHOW_CYCLE_TIMING
	bool "show spi read/write/erase cycle timing"
	default n if ARCH_GODSMART
	default n if ARCH_PHOENIX
	default n if (ARCH_HI3518 || ARCH_HI3535 || ARCH_HI3520D || ARCH_HI3516A)
	help
	  Show spi read/write/erase cycle timing, command, clock.
	  This is a debug option. When enabled, some command and
	  cycles uesed on operations will show for you.
	  If unsure, say no.

config HISFC350_ENABLE_CHIPSELECT_0
	bool "use spi device on chipselect 0"
	default n if ARCH_GODSMART
	default n if ARCH_PHOENIX
	default n if (ARCH_HI3518 || ARCH_HI3535 || ARCH_HI3520D || ARCH_HI3516A)

config HISFC350_ENABLE_CHIPSELECT_1
	bool "use spi device on chipselect 1"
	default y if ARCH_GODSMART
	default y if ARCH_PHOENIX
	default y if (ARCH_HI3518 || ARCH_HI3535 || ARCH_HI3520D || ARCH_HI3516A)

config HISFC350_ENABLE_INTR_DMA
	bool "use the IRQ mode of spi device R/W"
	default n if (ARCH_HI3535 || ARCH_HI3516A)

config CMD_SPI_BLOCK_PROTECTION
	bool "enable the SPI nor flash block protection"
	default y if (ARCH_HI3516A)

endif # MTD_HISFC350
```

## linux/linux-3.4.y/drivers/mtd/nand/hifmc100/Kconfig
```kconfig
#
# hisilicon flash memory controller SPI nand device driver version 100
# drivers/mtd/nand/hifmc100/Kconfig
# add by hisilicon 2014.10.9
#

menuconfig HIFMC100_SPI_NAND
	tristate "Hisilicon Flash Memory Controller v100 SPI Nand device Support"
	depends on HIFMC
	depends on MTD_NAND
	depends on HIFMC_SPI_NAND
	default y if ARCH_HI3518EV200
	select YAFFS_FS
	select MISC_FILESYSTEMS
	select MTD_BLOCK
	select YAFFS_YAFFS2
	help
	  Hisilicon Flash Memory Controller device version 100 driver Support
	  Hisilicon Flash Memory Controller version 100 is called hifmc100 for
	  short. The controller driver support registers and DMA transfers
	  while reading or writing the SPI nand flash.

if HIFMC100_SPI_NAND

config SPI_NAND_MAX_CHIP_NUM
	int "Support max number of SPI Nand flash chip (1, 2)"
	default 1 if ARCH_HI3518EV200
	help
	  flash memory controller v100 device only support 1 or 2 SPI nand flash
	  chip, your should not config other value.

choice
	prompt "Page Size and Ecc Type Select"
	default HIFMC100_AUTO_PAGESIZE_ECC if ARCH_HI3518EV200

config HIFMC100_HARDWARE_PAGESIZE_ECC
	bool "Hardware"
	help
	  the configure of page size and ecc type
	  lie on switch on the board.
	  so the page size and ecc type is controlled by
	  Hardware see demo board of SOC.

config HIFMC100_AUTO_PAGESIZE_ECC
	bool "Auto"
	help
	  auto-sensed the page size and ecc type value. driver will try each of
	  page size and ecc type one by one till flash can be read and wrote
	  accurately. so the page size and ecc type is match adaptively without
	  switch on the board

config HIFMC100_PAGESIZE_AUTO_ECC_NONE
	bool "Pagesize Auto, Ecc None"
	help
	  auto-sensed the page size and select ecc none. driver will try each
	  of page size one by one till flash can be read and wrote accurately.
	  so the page size is match adaptively without switch on the board

endchoice

endif # End of HIFMC100_SPI_NAND
```
