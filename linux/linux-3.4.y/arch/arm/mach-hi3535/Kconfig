## linux/linux-3.4.y/drivers/net/ethernet/hieth-sf/Kconfig
```kconfig
#
# hieth family network device configuration
#

menuconfig HIETH_SWITCH_FABRIC
	tristate "hieth(switch fabric) family network device support"
	depends on (ARCH_HI3518EV200)
	default y if (ARCH_HI3518EV200)
	select PHYLIB
	help
	  This selects the hieth family network device.The hieth
	  switch fabric (SF) receives and transmits data over two Ethernet
	  ports at 10/100 Mbit/s in full-duplex or half-duplex mode.
	  The Ethernet port exchanges data with the CPU port, and supports
	  the energy efficient Ethernet (EEE).

if HIETH_SWITCH_FABRIC

config HIETH_TAG
	hex "hieth tag"
	default "0x726d6d73"
	help
	  This is graceful set mac in kernel.

config HIETH_IOBASE
	hex "hieth IO address"
	default "0x10090000" if (ARCH_HI3518EV200)

config HIETH_IOSIZE
	hex "hieth IO size"
	default "0x00010000"
	help
	  default is 0x10000.

config HIETH_IRQNUM
	int "hieth irq number"
	default "12" if ARCH_HI3518EV200

config EEE_SUPPORT
	bool "eee support"
	depends on (ARCH_HI3518EV200)
	default n if ARCH_HI3518EV200
	help
	  default is disabled.
	  The energy efficient Ethernet (EEE).
	  Use EEE to save power of MAC and PHY.
	  If supported, say Y here.

config TX_FLOW_CTRL_SUPPORT
	bool "tx flow ctrl supported"
	default y
	help
	  Tx flow ctrl supported, default is enabled.
	  When we has no buffer to receive packet,
	  we will send pause frame.
	  Rx flow ctrl default is enabled, cannot be disabled.

config TX_FLOW_CTRL_ACTIVE_THRESHOLD
	int "tx flow ctrl active threshold"
	default "3"
	range 1 31
	help
	  The threshold for activing tx flow ctrl.
	  When the left amount of receive queue descriptors is below this threshold,
	  hardware will send pause frame immediately.
	  We advise this value is set between 1 and 10. Too bigger is not a good choice.
	  This value must be smaller than tx flow ctrl deactive threshold.

config TX_FLOW_CTRL_DEACTIVE_THRESHOLD
	int "tx flow ctrl deactive threshold"
	default "5"
	range 1 31
	help
	  The threshold for deactiving tx flow ctrl.
	  When the left amount of receive queue descriptors is above or equal with this threshold,
	  hardware will exit flow control state.
	  We advise this value is set between 1 and 10. Too bigger is not a good choice.
	  This value must be larger than tx flow ctrl active threshold.

config HIETH_MONITOR_TIMER
	int "hieth monitor timer"
	default "10" if (ARCH_HI3518EV200)
	help
	  hieth monitor timer, default is 10ms.

config HIETH_HWQ_XMIT_DEPTH
	int "hieth hardware queue send fifo depth"
	range 1 63
	default "12" if (ARCH_HI3518EV200)
	help
	  This selects choice optimize RX or TX performance.
	  Default is 12(optimize RX performance).
	  If you need optimize TX performance, increase this factor maybe is good choice.

config HIETH_MDIO_FRQDIV
	int "hieth mdio frequency factor"
	default "2" if (ARCH_HI3518EV200)

config HIETH_MII_RMII_MODE_U
	int "hieth mii/rmii mode for up port (mii:0/rmii:1)"
	range 0 1
	default "1" if (ARCH_HI3518EV200)
	help
	  hieth mode as mii:0/rmii:1 for up port.

config HIETH_MII_RMII_MODE_D
	int "hieth mii/rmii mode for down port (mii:0/rmii:1)"
	range 0 1
	default "1" if (ARCH_HI3518EV200)
	help
	  hieth mode as mii:0/rmii:1 for down port.

config HIETH_PHYID_U
	int "hieth phyid for up port"
	range 0 31
	default "1"
	help
	  hieth phyid for up port.

config HIETH_PHYID_D
	int "hieth phyid for down port"
	range 0 31
	default "3"
	default "0" if (ARCH_GODNET || ARCH_GODCUBE)
	help
	  hieth phyid addr for down port.

config HIETH_DOWNPORT_EN
	bool "enable hieth down port"
	default y if (ARCH_GODNET || ARCH_GODCUBE || ARCH_GODBOX_V1 || ARCH_GODVIEW || ARCH_GODBOX || ARCH_PHOENIX)
	help
	  Hieth down port controller, to enable or disable down port.
	  If the eth controller support only one port, do not enable this option.
	  Otherwise some error information will appear during hieth init.
	  If the eth controller support two port, say Y here.

config HIETH_MAX_RX_POOLS
	int "hieth max rx pool size"
	default "1024"
	help
	  hieth max static rx pool size.

config HIETH_TRACE_LEVEL
	int "hieth trace(debug) level"
	range 0 18
	default "18"
	help
	  hieth trace(debug) level

config HIETH_RESET_HELPER_EN
	bool "hieth reset helper"
	default y
	default n if (ARCH_GODNET || ARCH_GODCUBE || ARCH_HI3518EV200)
	help
	  hieth phy reset gpio helper.
	  some external phy need to be reset before use, so we
	  use gpio to reset it.
	  If we use CRG to reset external phy, say N here.

config HIETH_RESET_HELPER_GPIO_BASE
	hex "hieth reset helper on which gpio group"
	depends on HIETH_RESET_HELPER_EN
	default "0x20140000" if (ARCH_HI3518EV200)
	help
	  hieth gpio group for reset.

config HIETH_RESET_HELPER_GPIO_BIT
	int "hieth reset helper on gpio bit"
	depends on HIETH_RESET_HELPER_EN
	range 0 7
	default "5" if (ARCH_HI3518EV200)
	help
	  hieth gpio group bit for reset.

config HIETH_RESET_HELPER_GPIO_VALUE
	int "hieth reset helper on gpio value"
	depends on HIETH_RESET_HELPER_EN
	range 0 1
	default "0" if (ARCH_HI3518EV200)
	help
	  hieth gpio reset value.

endif # HIETH_SWITCH_FABRIC

#vim: set ts=8 sw=8 tw=78:
```

## linux/linux-3.4.y/drivers/net/ethernet/stmmac/Kconfig
```kconfig
menuconfig STMMAC_ETH_TNK
	tristate "STMicroelectronics 10/100/1000 Ethernet driver, TNK added"
	select MII
	select PHYLIB
	select CRC32
	depends on NETDEVICES && HAS_IOMEM && (ARCH_HI3535)
	help
	  This is the driver for the Ethernet IPs are built around a
	  Synopsys IP Core and only tested on the STMicroelectronics
	  platforms.

if STMMAC_ETH_TNK

config STMMAC_DA
	bool "STMMAC DMA arbitration scheme"
	default n
	help
	  Selecting this option, rx has priority over Tx (only for Giga
	  Ethernet device).
	  By default, the DMA arbitration scheme is based on Round-robin
	  (rx:tx priority is 1:1).

config STMMAC_DUAL_MAC
	bool "STMMAC: dual mac support"
	default y if ARCH_HI3535
        depends on STMMAC_ETH_TNK
	help
	  The Huawei Hi3521 soCs has only one Ethernet Controllers.
	  The Huawei Hi35XX SoCs may have two Ethernet Controllers.
	  This option turns on the second Ethernet device
	  if required.

config STMMAC_TIMER
	bool "STMMAC Timer optimisation"
	default n
	depends on RTC_HCTOSYS_DEVICE
	help
	  Use an external timer for mitigating the number of network
	  interrupts. Currently, for SH architectures, it is possible
	  to use the TMU channel 2 and the SH-RTC device.

choice
        prompt "Select Timer device"
        depends on STMMAC_TIMER

config STMMAC_TMU_TIMER_TNK
        bool "TMU channel 2"
        depends on CPU_SH4
	help
	  Use an external timer for mitigating the number
	  of network interrupts. Currently, for SH
	  architectures, it is possible to use the TMU
	  channel 2 device.

config STMMAC_RTC_TIMER_TNK
        bool "Real time clock"
        depends on RTC_CLASS
	help
	  Use an external timer for mitigating the number
	  of network interrupts. Currently, for SH
	  architectures, it is possible to use the SH-RTC
	  device.

endchoice

config STMMAC_IOADDR
	hex "STMMAC IO address"
	default "0x12020000" if (ARCH_HI3535)

config STMMAC_IOSIZE
	hex "STMMAC IO size"
	default "0x00020000"

config STMMAC_IRQNUM
	int "STMMAC irq number"
	default "59" if ARCH_HI3535

config STMMAC_SYS_IOADDR
	hex "STMMAC System Config IO address"
	default "0x20030000" if (ARCH_HI3535)

config STMMAC_SYS_IOSIZE
	hex "STMMAC System Config IO size"
	default "0x00000100"

config STMMAC_PHY0_ID
	hex "STMMAC MAC #0 PHY ID"
	default 1 if (ARCH_HI3535)

config STMMAC_PHY1_ID
	hex "STMMAC MAC #1 PHY ID"
	default 2 if (ARCH_HI3535)
	depends on STMMAC_DUAL_MAC

config STMMAC_PHY0_INTERFACE_MODE
       hex "STMMAC PHY0 MDIO INTERFACE"
       default 6 if (ARCH_HI3535)
       depends on STMMAC_ETH_TNK
       help
       Hi35XX support rgmii, rmii, mii interface mode,
       if you use mii mode, please set 1 as default value.
       if you use rmii mode, please set 5 as default value.
       hi35XX use rgmii(6) as default mido interface mode.

       /* Interface Mode definitions */
       typedef enum {
               PHY_INTERFACE_MODE_NA,          /* 0x0 */
               PHY_INTERFACE_MODE_MII,         /* 0x1 */
               PHY_INTERFACE_MODE_GMII,        /* 0x2 */
               PHY_INTERFACE_MODE_SGMII,       /* 0x3 */
               PHY_INTERFACE_MODE_TBI,         /* 0x4 */
               PHY_INTERFACE_MODE_RMII,        /* 0x5 */
               PHY_INTERFACE_MODE_RGMII,       /* 0x6 */
               PHY_INTERFACE_MODE_RGMII_ID,    /* 0x7 */
               PHY_INTERFACE_MODE_RGMII_RXID,  /* 0x8 */
               PHY_INTERFACE_MODE_RGMII_TXID,  /* 0x9 */
               PHY_INTERFACE_MODE_RTBI,        /* 0xa */
               PHY_INTERFACE_MODE_SMII,        /* 0xb */
       } phy_interface_t;

config STMMAC_PHY1_INTERFACE_MODE
       hex "STMMAC PHY1 MDIO INTERFACE"
       default 6 if (ARCH_HI3535)
       depends on STMMAC_ETH_TNK
       help
       Hi35XX support rgmii, rmii, mii interface mode,
       if you use mii mode, please set 1 as default value.
       if you use rmii mode, please set 5 as default value.
       hi35XX use rgmii(6) as default mido interface mode.

       /* Interface Mode definitions */
       typedef enum {
               PHY_INTERFACE_MODE_NA,          /* 0x0 */
               PHY_INTERFACE_MODE_MII,         /* 0x1 */
               PHY_INTERFACE_MODE_GMII,        /* 0x2 */
               PHY_INTERFACE_MODE_SGMII,       /* 0x3 */
               PHY_INTERFACE_MODE_TBI,         /* 0x4 */
               PHY_INTERFACE_MODE_RMII,        /* 0x5 */
               PHY_INTERFACE_MODE_RGMII,       /* 0x6 */
               PHY_INTERFACE_MODE_RGMII_ID,    /* 0x7 */
               PHY_INTERFACE_MODE_RGMII_RXID,  /* 0x8 */
               PHY_INTERFACE_MODE_RGMII_TXID,  /* 0x9 */
               PHY_INTERFACE_MODE_RTBI,        /* 0xa */
               PHY_INTERFACE_MODE_SMII,        /* 0xb */
       } phy_interface_t;

endif
```

## linux/linux-3.4.y/drivers/pci/hipcie/Kconfig
```kconfig
menuconfig HIPCIE
	bool "Hisilicon PCI Express support"
	depends on PCI && ARCH_HI3535
	default y if PCI
	default n if ! PCI
	help
	Hisilicon PCI Express support
	Choose this selection to support PCI Express uses.

if HIPCIE

menu "PCI Express configs"

config PCIE0_SEL
        int "PCI Express controller0 sel"
        range 0 1
        default "0" if ! PCI
        default "1" if PCI
        depends on PCI
        help
        PCI Express controller0 sel.
        Set 0 to disable controller 0,
        set 1 to enable controller 0 to work at x1 mode.
        PCIe controller0 is available for all hi35xx chips

config PCIE0_DEVICES_MEM_SIZE
        hex "Total memory size of PCI Express system devices"
        range 0x0 0x7800000 if ARCH_HI3535
        default "0x7800000" if ARCH_HI3535
        depends on PCI
        help
        All memory size required by all devices in pci subsystem.
        Hisilicon PCI Express controller provide up to 128M memory
        and io size for device.
        Here we set memory size up to 120M, means that io size has at least 8M
        You can change this depend on you device connected
        to Hisilicon PCI Express controller.

config PCIE0_DEVICES_CONFIG_SIZE
        hex "Total configuration header size of PCI Express system devices"
        range 0x0 0x10000000   if ARCH_HI3535
        default 0x800000       if ARCH_HI3535
        depends on PCI
        help
        All configuration size required by devices connnect to
        Hisilicon PCI Express controller.
        NOTE: This will alloc memory from kernel,
        enlarge this will require the same memory.
        The default value is enough for most applications.

if GODNET

config PCIE1_SEL
	int "PCI Express controller1 sel"
	range 0 1
	default "0"
	depends on PCI
	help
	PCI Express controller1 sel.
	Set 0 to disable controller 1,
	set 1 to enable controller 1 to work at x1 mode.
	Currently, this setting is only available for those chips that support 2 PCIE controllers,
	Other chips will not support PCIe controller 1.

config PCIE1_DEVICES_MEM_SIZE
	hex "Total memory size of PCI Express system devices"
	range 0x0 0x7800000 if PCIE1_SEL
	default "0x7800000" if PCIE1_SEL
	depends on PCI && PCIE1_SEL
	help
	All memory size required by all devices in pci subsystem.
	Hisilicon PCI Express controller provide up to 128M memory
	and io size for device.
	Here we set memory size up to 120M, means that io size has at least 8M
	You can change this depend on you device connected
	to Hisilicon PCI Express controller.

config PCIE1_DEVICES_CONFIG_SIZE
	hex "Total configuration header size of PCI Express system devices"
	range 0x0 0x10000000   if PCIE1_SEL
	default 0x800000       if PCIE1_SEL
	depends on PCI && PCIE1_SEL
	help
	All configuration size required by devices connnect to
	Hisilicon PCI Express controller.
	NOTE: This will alloc memory from kernel,
	enlarge this will require the same memory.
	The default value is enough for most applications.

endif

endmenu

endif
```

## linux/linux-3.4.y/drivers/usb/gadget/hi_hs_dev/Kconfig
```kconfig
#
# hisilicon usb2 device controller version 3.00a
#

menuconfig HI_HS_DEVICE
	tristate "hisilicon highspeed device controller version 3.00a driver"
	default n
	select USB_GADGET_DUALSPEED
	select USB_GADGET_SELECTED
	help
	  hisilicon highspeed device controller version 3.00a.
	  The USB 2.0 device controller supports high-speed (480 Mbit/s)
	  and full-speed (12 Mbit/s) data transfer modes. It also supports
	  host/device intelligent switching. 

if HI_HS_DEVICE

config HIUSBUDC_REG_BASE_ADDRESS
	hex "hisilicon highspeed device control register base address"
	default "0xf98c0000" if ARCH_S40
	default "0x60180000" if ARCH_GODBOX
	default "0x10080000" if ARCH_HI3516A
	default "0x10080000" if ARCH_HI3501

config HIUSBUDC_REG_BASE_ADDRESS_LEN
	hex "hisilicon highspeed device control register size length"
	default "0x40000" if ARCH_S40
	default "0x40000" if ARCH_GODBOX
	default "0x40000" if ARCH_HI3516A
	default "0x40000" if ARCH_HI3501

config HIUSBUDC_IRQ_NUMBER
	int "hisilicon highspeed device interrupt number"
	default "100" if ARCH_S40
	default "103" if ARCH_GODBOX
	default "55" if ARCH_HI3516A
	default "12" if ARCH_HI3501

config HIUSBUDC_DMA_BUF_LENGTH
	int "hisilicon highspeed device dma buffer length"
	default "512" if ARCH_S40
	default "16384" if ARCH_GODBOX
	default "16384" if ARCH_HI3516A
	default "16384" if ARCH_HI3501
config HIUSBUDC_PHY_UTMI_BITWIDTH
	int "hisilicon highspeed device phy interface utmi bitwidth"
	default "16"
endif # HI_HS_DEVICE
```
