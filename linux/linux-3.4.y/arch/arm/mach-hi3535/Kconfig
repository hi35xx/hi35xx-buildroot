## linux/linux-3.4.y/drivers/usb/host/Kconfig.hiusb2_0
```kconfig
#
# hiusb Host Controller Drivers
#
comment "hiusb(ehci/ohci) Host Controller Drivers"
	depends on USB

menuconfig HIUSB_HOST2_0
	bool "hiusb2.0 usb host support"
	depends on ARCH_HI3535 || ARCH_HI3516A || ARCH_HI3518EV200
	default y if ARCH_HI3535 || ARCH_HI3516A || ARCH_HI3518EV200
	select USB
	select USB_ARCH_HAS_EHCI
	select USB_ARCH_HAS_OHCI
	help
          This selects the usb(ehci/ohci) family usb host.
	  Say Y to enable hisi usb2.0 controller driver.
	  IF you do not use usb2.0 device in your board,
	  say N to get a smaller uImage. Mostly you need it.

if HIUSB_HOST2_0
config HIUSB_HOST
	bool "hisilicon usb host controller support"
	depends on ARCH_HI3535 || ARCH_HI3516A || ARCH_HI3518EV200
	default y if ARCH_HI3535 || ARCH_HI3516A || ARCH_HI3518EV200
	help
	  You can select host mode by the option.
	  when you select the option, usb2 host
	  control will be initialization.
	  But you should add ehci and ohci driver option.

config HIUSB_EHCI
	bool "hiusb-ehci usb host device support"
	depends on ARCH_HI3535 || ARCH_HI3516A || ARCH_HI3518EV200
	default y if ARCH_HI3535 || ARCH_HI3516A || ARCH_HI3518EV200
	help
	  Enable hisi ehci controller driver.
	  Say Y to enable hisi usb2.0 ehci controller driver.
	  IF you do not use usb2.0 ehci device in your board, say N to get a
	  smaller uImage. Mostly you need it.

config HIUSB_EHCI_IOBASE
	hex "hiusb-ehci IO address"
	default "0x10040000" if ARCH_HI3535
	default "0x100b0000" if ARCH_HI3516A || ARCH_HI3518EV200

config HIUSB_EHCI_IOSIZE
	hex "hiusb-ehci IO size"
	default "0x00010000"
	help
	  default is 0x10000.

config HIUSB_EHCI_IRQNUM
	int "hiusb-ehci irq number"
	default "54" if ARCH_HI3535
	default "53" if ARCH_HI3516A
	default "15" if ARCH_HI3518EV200
	help
	  Please use the default value in this Kconfig, The default value
	  is the right value provided by hisi.

config HIUSB_OHCI
	bool "hiusb-ohci usb host device support"
	depends on ARCH_HI3535 || ARCH_HI3516A  || ARCH_HI3518EV200
	default y if ARCH_HI3535 || ARCH_HI3516A || ARCH_HI3518EV200
	help
	  Enable hisi ohci controller driver.
	  Say Y to enable hisi usb2.0 ohci controller driver.
	  IF you do not use usb2.0 ohci device in your board, say N to get a
	  smaller uImage. Mostly you need it.

config HIUSB_OHCI_IOBASE
	hex "hiusb-ohci IO address"
	default "0x10030000" if ARCH_HI3535
	default "0x100a0000" if ARCH_HI3516A || ARCH_HI3518EV200

config HIUSB_OHCI_IOSIZE
	hex "hiusb-ohci IO size"
	default "0x00010000"
	help
	  default is 0x10000.

config HIUSB_OHCI_IRQNUM
	int "hiusb-ohci irq number"
	default "53" if ARCH_HI3535
	default "54" if ARCH_HI3516A
	default "16" if ARCH_HI3518EV200
	help
	  Please use the default value in this Kconfig, The default value
	  is the right value provided by hisi.
endif # HIUSB_HOST2_0

menuconfig HIUSB_DEVICE2_0
	bool "hiusb2.0 usb device support"
	depends on ARCH_HI3516A || ARCH_HI3518EV200
	default y if ARCH_HI3516A || ARCH_HI3518EV200
	select USB_GADGET_DUALSPEED
	select USB_GADGET_SELECTED
	help
          This selects the usb(ehci/ohci) family usb device.
	  Say Y to enable hisi usb2.0 controller driver.
	  IF you do not use usb2.0 device in your board,
	  say N to get a smaller uImage. Mostly you need it.

if HIUSB_DEVICE2_0

config HIUSB_DEVICE
	tristate "hisilicon highspeed device controller version 3.00a driver"
	depends on ARCH_HI3516A || ARCH_HI3518EV200
	default y if ARCH_HI3516A || ARCH_HI3518EV200
	help
	  You can select device mode by the option.
	  Enable hisi ehci controller driver.
	  Say Y to enable hisi usb2.0 ehci controller driver.
	  IF you do not use usb2.0 ehci device in your board, say N to get a
	  smaller uImage. Mostly you need it.

config HIUSBUDC_REG_BASE_ADDRESS
	hex "hisilicon highspeed device control register base address"
	default "0x10080000" if ARCH_HI3516A || ARCH_HI3518EV200

config HIUSBUDC_REG_BASE_ADDRESS_LEN
	hex "hisilicon highspeed device control register size length"
	default "0x40000" if ARCH_HI3516A || ARCH_HI3518EV200

config HIUSBUDC_IRQ_NUMBER
	int "hisilicon highspeed device interrupt number"
	default "55" if ARCH_HI3516A
	default "10" if ARCH_HI3518EV200

config HIUSBUDC_DMA_BUF_LENGTH
	int "hisilicon highspeed device dma buffer length"
	default "16384" if ARCH_HI3516A || ARCH_HI3518EV200

config HIUSBUDC_PHY_UTMI_BITWIDTH
	int "hisilicon highspeed device phy interface utmi bitwidth"
	default "8"
endif # HI_HS_DEVICE
```

## linux/linux-3.4.y/drivers/usb/host/Kconfig.hiusb3_0
```kconfig
#
# hiusb3.0(xhci/ehci/ohci) Host Controller Drivers
#
comment "hiusb3.0(xhci/ehci/ohci) Host Controller Drivers"
	depends on USB

menuconfig HIUSB_HOST3_0
	bool "hiusb3.0(xhci/ehci/ohci) family usb host device support"
	default y
	select USB
	select USB_ARCH_HAS_EHCI
	select USB_ARCH_HAS_OHCI
	select USB_ARCH_HAS_XHCI
	select USB_XHCI_PLATFORM
	help
	  This selects the usb(xhci/ehci/ohci) family usb host device.
	  Say Y to enable hisi usb3.0 controller driver.
	  IF you do not use usb3.0 device in your board, say N to get a
	  smaller uImage. Mostly you need it.

if HIUSB_HOST3_0

config HIUSB_XHCI_HCD
	bool "hiusb-xhci usb host device support"
	depends on ARCH_HI3535
	default y if ARCH_HI3535
	help
	  Enable hisi3.0 xhci controller driver.
	  Say Y to enable hisi usb3.0 controller driver.
	  IF you do not use usb3.0 device in your board, say N to get a
	  smaller uImage. Mostly you need it.

config HIUSB_XHCI_IOBASE
	hex "hiusb-xhci IO address"
	depends on ARCH_HI3535
	default "0x12000000" if ARCH_HI3535

config HIUSB_XHCI_IOSIZE
	hex "hiusb-xhci IO size"
	depends on ARCH_HI3535
	default "0x00010000"
	help
	  default is 0x10000.

config HIUSB_XHCI_IRQNUM
	int "hiusb-xhci irq number"
	depends on ARCH_HI3535
	default "64" if ARCH_HI3535

endif
```

## package/archivemount/Config.in
```kconfig
comment "archivemount needs a toolchain w/ thread, dynamic library"
	depends on BR2_USE_MMU
	depends on !BR2_TOOLCHAIN_HAS_THREADS || BR2_STATIC_LIBS

config BR2_PACKAGE_ARCHIVEMOUNT
	bool "archivemount (FUSE)"
	depends on BR2_TOOLCHAIN_HAS_THREADS # libfuse
	depends on BR2_USE_MMU # libfuse
	depends on !BR2_STATIC_LIBS # libfuse
	select BR2_PACKAGE_LIBFUSE
	select BR2_PACKAGE_LIBARCHIVE
	help
	  Gateway between FUSE and libarchive. Allows mounting of
	  cpio, .tar.gz, .tar.bz2 archives, reading and writing
	  supported. 

	  http://www.cybernoia.de/software/archivemount/
```

## package/exfat-nofuse/Config.in
```kconfig
config BR2_PACKAGE_EXFAT_NOFUSE
	bool "exFAT (noFUSE)"
	depends on BR2_LINUX_KERNEL
	help
	  Linux non-fuse read/write kernel driver for the exFAT, FAT12,
	  FAT16 and vfat (FAT32) file systems.

	  https://github.com/dorimanx/exfat-nofuse

comment "exfat-nofuse needs a Linux kernel to be built"
	depends on BR2_USE_MMU
	depends on !BR2_LINUX_KERNEL
```

## package/gsoap/Config.in
```kconfig
config BR2_PACKAGE_GSOAP
	bool "gsoap"
	depends on BR2_INSTALL_LIBSTDCPP
	help
	  The gSOAP Web services development toolkit offers an XML to C/C++
	  language binding to ease the development of SOAP/XML Web services in C
	  and C/C++.

	  http://sourceforge.net/projects/gsoap2/

comment "gsoap needs a toolchain w/ C++, threads"
	depends on !BR2_INSTALL_LIBSTDCPP
```

## package/himpp/Config.in
```kconfig
config BR2_PACKAGE_HIMPP
	bool "himpp"
	depends on BR2_arm
	help
	  Hisilicon Media Processing Platform

if BR2_PACKAGE_HIMPP

choice
	bool "himpp for chip"
	default BR2_PACKAGE_HIMPP_HI3518V100
	help
	  Select chip support for mpp

config BR2_PACKAGE_HIMPP_HI3516EV200
	bool "hi3516ev200"
	help
	  MPP for Hi3516EV200/Hi3516EV300/Hi3518EV300 chips

config BR2_PACKAGE_HIMPP_HI3518V100
	bool "hi3518/hi3516 v100"
	help
	  MPP for Hi3518 / Hi3516 v100 chips

config BR2_PACKAGE_HIMPP_HI3518V200
	bool "hi3518/hi3516 v200"
	help
	  MPP for Hi3518 / Hi3518 v200 chips

config BR2_PACKAGE_HIMPP_HI3520V100
	bool "hi3520/hi3521 v100"
	help
	  MPP for Hi3520 / Hi3521 v100 chips

config BR2_PACKAGE_HIMPP_HI3520DV200
	bool "hi3520d v200"
	help
	  MPP for Hi3520D v200 chips

endchoice

config BR2_PACKAGE_HIMPP_CHIP
	string
	default "hi3516ev200" if BR2_PACKAGE_HIMPP_HI3516EV200
	default "hi3518v100" if BR2_PACKAGE_HIMPP_HI3518V100
	default "hi3518v200" if BR2_PACKAGE_HIMPP_HI3518V200
	default "hi3520v100" if BR2_PACKAGE_HIMPP_HI3520V100
	default "hi3520dv200" if BR2_PACKAGE_HIMPP_HI3520DV200

if BR2_PACKAGE_HIMPP_HI3516EV200
source "package/himpp/himpp-hi3516ev200/Config.in"
endif # BR2_PACKAGE_HIMPP_HI3516EV200

if BR2_PACKAGE_HIMPP_HI3518V100
source "package/himpp/himpp-hi3518v100/Config.in"
endif # BR2_PACKAGE_HIMPP_HI3518V100

if BR2_PACKAGE_HIMPP_HI3518V200
source "package/himpp/himpp-hi3518v200/Config.in"
endif # BR2_PACKAGE_HIMPP_HI3518V200

if BR2_PACKAGE_HIMPP_HI3520V100
source "package/himpp/himpp-hi3520v100/Config.in"
endif # BR2_PACKAGE_HIMPP_HI3520V100

if BR2_PACKAGE_HIMPP_HI3520DV200
source "package/himpp/himpp-hi3520dv200/Config.in"
endif # BR2_PACKAGE_HIMPP_HI3520DV200

endif # BR2_PACKAGE_HIMPP
```

## package/himpp/himpp-hi3516ev200/Config.in
```kconfig
comment "Options for hi3516ev200 mpp"

config BR2_PACKAGE_HIMPP_PREFIX
	string "Install prefix"
	default "/usr"
	help
	  Prefix to install himpp on the target file system.

choice
	bool "SDK Version"
	default BR2_PACKAGE_HIMPP_HI3516EV200_SDK_V1_0_1_2

config BR2_PACKAGE_HIMPP_HI3516EV200_SDK_V1_0_1_2
	bool "1.0.1.2"

endchoice

choice
	bool "Board"
	default BR2_PACKAGE_HIMPP_HI3516EV200_BOARD_HI3516EV200

config BR2_PACKAGE_HIMPP_HI3516EV200_BOARD_HI3516EV200
	bool "hi3516ev200"

config BR2_PACKAGE_HIMPP_HI3516EV200_BOARD_HI3516EV300
	bool "hi3516ev300"

config BR2_PACKAGE_HIMPP_HI3516EV200_BOARD_HI3518EV300
	bool "hi3518ev300"

endchoice

config BR2_PACKAGE_HIMPP_HI3516EV200_SDK_VERSION
	string
	default "1.0.1.2" if BR2_PACKAGE_HIMPP_HI3516EV200_SDK_V1_0_1_2
```

## package/himpp/himpp-hi3518/Config.in
```kconfig
comment "Options for hi3518 mpp2"

config BR2_PACKAGE_HIMPP_PREFIX
	string "Install prefix"
	default "/opt/himpp2"
	help
	  Prefix to install himpp2 on the target file system.

menu "Sensor driver libraries"

config BR2_PACKAGE_HIMPP_SNSDRV_APTINA_9M034
	bool "Aptina 9M034"
	default y

config BR2_PACKAGE_HIMPP_SNSDRV_APTINA_AR0130
	bool "Aptina AR0130"
	default y

config BR2_PACKAGE_HIMPP_SNSDRV_APTINA_AR0330
	bool "Aptina AR0330"
	default y

config BR2_PACKAGE_HIMPP_SNSDRV_APTINA_MT9P006
	bool "Aptina MT9P006"
	default y

config BR2_PACKAGE_HIMPP_SNSDRV_GALAXYCORE_GC1004
	bool "GalaxyCore GC1004"
	default y

config BR2_PACKAGE_HIMPP_SNSDRV_HIMAX_1375
	bool "Himax 1375"
	default y

config BR2_PACKAGE_HIMPP_SNSDRV_ONMI_OV9712
	bool "Onmi OV9712"
	default y

config BR2_PACKAGE_HIMPP_SNSDRV_ONMI_OV9712_PLUS
	bool "Onmi OV9712+"
	default y

config BR2_PACKAGE_HIMPP_SNSDRV_PANASONIC_MN34031
	bool "Panasonic MN34031"
	default y

config BR2_PACKAGE_HIMPP_SNSDRV_PANASONIC_MN34041
	bool "Panasonic MN34041"
	default y

config BR2_PACKAGE_HIMPP_SNSDRV_PIXELPLUS_3100K
	bool "PixelPlus 3100K"
	default y

config BR2_PACKAGE_HIMPP_SNSDRV_SOI_H22
	bool "SOI H22"
	default y

config BR2_PACKAGE_HIMPP_SNSDRV_SONY_ICX692
	bool "Sony ICX692"
	default y

config BR2_PACKAGE_HIMPP_SNSDRV_SONY_IMX104
	bool "Sony IMX104"
	default y

config BR2_PACKAGE_HIMPP_SNSDRV_SONY_IMX122
	bool "Sony IMX122"
	default y

config BR2_PACKAGE_HIMPP_SNSDRV_SONY_IMX138
	bool "Sony IMX138"
	default y

config BR2_PACKAGE_HIMPP_SNSDRV_SONY_IMX236
	bool "Sony IMX236"
	default y

endmenu


menu "External kernel module & utils"

config BR2_PACKAGE_HIMPP_EXTDRV_GPIO_I2C
	bool "gpio-i2c"
	default n
	help
	  gpio-i2c bit-bang i2c driver

config BR2_PACKAGE_HIMPP_EXTDRV_GPIO_I2C_EX
	bool "gpio-i2c-ex"
	default n
	help
	  gpio-i2c-ex bit-bang i2c driver

config BR2_PACKAGE_HIMPP_EXTDRV_HI_I2C
	bool "hi-i2c"
	default n
	help
	  hi-i2c hardware i2c driver

config BR2_PACKAGE_HIMPP_EXTDRV_PWM
	bool "pwm"
	default n

config BR2_PACKAGE_HIMPP_EXTDRV_SSP_AD9020
	bool "ssp-ad9020"
	default n

config BR2_PACKAGE_HIMPP_EXTDRV_SSP_PANA
	bool "ssp-pana"
	default n

config BR2_PACKAGE_HIMPP_EXTDRV_SSP_SONY
	bool "ssp-sony"
	default n

config BR2_PACKAGE_HIMPP_EXTDRV_TW2865
	bool "tw2865"
	default n
	depends on BR2_PACKAGE_HIMPP_EXTDRV_HI_I2C

endmenu

menuconfig BR2_PACKAGE_HIMPP_SAMPLES
	bool "Build MPP2 samples"
	default n
	depends on BR2_PACKAGE_HIMPP_HI3518
	help
	  Build samples for HiMPP2 for HI3518

if BR2_PACKAGE_HIMPP_SAMPLES

choice
	bool "Sensor Type"
	default BR2_PACKAGE_HIMPP_SNS_OMNI_OV9712
	help
	  Sensor type for Hi3518

config BR2_PACKAGE_HIMPP_SNS_APTINA_9M034
	bool "Aptina 9M034"
	help
	  Aptina 9m034

config BR2_PACKAGE_HIMPP_SNS_APTINA_AR0130
	bool "Aptina AR0130"
	help
	  Aptina AR0130

config BR2_PACKAGE_HIMPP_SNS_APTINA_AR0330
	bool "Aptina AR0330"
	help
	  Aptina AR0330

config BR2_PACKAGE_HIMPP_SNS_HIMAX_1375
	bool "Himax 1375"
	help
	  Himax 1375

config BR2_PACKAGE_HIMPP_SNS_OMNI_OV2710
	bool "Omni OV2710"
	help
	  Omni OV2710

config BR2_PACKAGE_HIMPP_SNS_OMNI_OV9712
	bool "Omni OV9712"
	help
	  Omni OV9712

config BR2_PACKAGE_HIMPP_SNS_PANASONIC_MN34031
	bool "Panasonic MN34031"
	help
	  Panasonic MN34031

config BR2_PACKAGE_HIMPP_SNS_PIXELPLUS_3100K
	bool "PixelPlus 3100K"
	help
	  PixelPlus 3100K

config BR2_PACKAGE_HIMPP_SNS_SOI_H22
	bool "SOI H22"
	help
	  SOI H22

config BR2_PACKAGE_HIMPP_SNS_SONY_ICX692
	bool "Sony ICX692"
	help
	  Sony ICX692

config BR2_PACKAGE_HIMPP_SNS_SONY_IMX104
	bool "Sony IMX104"
	help
	  Sony IMX104

config BR2_PACKAGE_HIMPP_SNS_SONY_IMX122
	bool "Sony IMX122"
	help
	  Sony IMX122

config BR2_PACKAGE_HIMPP_SNS_SONY_IMX138
	bool "Sony IMX138"
	help
	  Sony IMX138

config BR2_PACKAGE_HIMPP_SNS_SONY_IMX236
	bool "Sony IMX236"
	help
	  Sony IMX236

endchoice

config BR2_PACKAGE_HIMPP_SNS_TYPE
	string
	default APTINA_AR0130_DC_720P_30FPS if BR2_PACKAGE_HIMPP_SNS_APTINA_AR0130
	default APTINA_AR0330_DC_1080P_30FPS if BR2_PACKAGE_HIMPP_SNS_APTINA_AR0330
	default APTINA_9M034_DC_720P_30FPS if BR2_PACKAGE_HIMPP_SNS_APTINA_9M034
	default HIMAX_1375_DC_720P_30FPS if BR2_PACKAGE_HIMPP_SNS_HIMAX_1375
	default OMNI_OV9712_DC_720P_30FPS if BR2_PACKAGE_HIMPP_SNS_OMNI_OV9712
	default OMNI_OV2710_DC_1080P_30FPS if BR2_PACKAGE_HIMPP_SNS_OMNI_OV2710
	default PANASONIC_MN34031_DC_720P_30FPS if BR2_PACKAGE_HIMPP_SNS_PANASONIC_MN34031
	default PIXELPLUS_3100K_DC_720P_30FPS if BR2_PACKAGE_HIMPP_SNS_PIXELPLUS_3100K
	default SOI_H22_DC_720P_30FPS if BR2_PACKAGE_HIMPP_SNS_SOI_H22
	default SONY_ICX692_DC_720P_30FPS if BR2_PACKAGE_HIMPP_SNS_SONY_ICX692
	default SONY_IMX104_DC_720P_30FPS if BR2_PACKAGE_HIMPP_SNS_SONY_IMX104
	default SONY_IMX122_DC_1080P_30FPS if BR2_PACKAGE_HIMPP_SNS_SONY_IMX122
	default SONY_IMX138_DC_720P_30FPS if BR2_PACKAGE_HIMPP_SNS_SONY_IMX138
	default SONY_IMX236_DC_1080P_30FPS if BR2_PACKAGE_HIMPP_SNS_SONY_IMX236

config BR2_PACKAGE_HIMPP_SAMPLES_AUDIO
	bool "audio"
	depends on BR2_PACKAGE_HIMPP_SAMPLES
	help
	  Build audio samples for hi3518

config BR2_PACKAGE_HIMPP_SAMPLES_HIFB
	bool "hifb"
	depends on BR2_PACKAGE_HIMPP_SAMPLES
	help
	  Build hifb samples for hi3518

config BR2_PACKAGE_HIMPP_SAMPLES_IQ
	bool "iq"
	depends on BR2_PACKAGE_HIMPP_SAMPLES
	help
	  Build iq samples for hi3518

config BR2_PACKAGE_HIMPP_SAMPLES_IVE
	bool "ive"
	depends on BR2_PACKAGE_HIMPP_SAMPLES
	help
	  Build ive samples for hi3518

config BR2_PACKAGE_HIMPP_SAMPLES_REGION
	bool "region"
	depends on BR2_PACKAGE_HIMPP_SAMPLES
	help
	  Build region samples for hi3518

config BR2_PACKAGE_HIMPP_SAMPLES_TDE
	bool "tde"
	depends on BR2_PACKAGE_HIMPP_SAMPLES
	help
	  Build tde samples for hi3518

config BR2_PACKAGE_HIMPP_SAMPLES_VDA
	bool "vda"
	depends on BR2_PACKAGE_HIMPP_SAMPLES
	help
	  Build vda samples for hi3518

config BR2_PACKAGE_HIMPP_SAMPLES_VENC
	bool "venc"
	depends on BR2_PACKAGE_HIMPP_SAMPLES
	help
	  Build venc samples for hi3518

config BR2_PACKAGE_HIMPP_SAMPLES_VIO
	bool "vio"
	depends on BR2_PACKAGE_HIMPP_SAMPLES
	help
	  Build vio samples for hi3518

endif #BR2_PACKAGE_HIMPP_SAMPLES
```
