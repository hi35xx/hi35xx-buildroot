## linux/linux-3.18.y/drivers/pci/hipcie/Kconfig
```kconfig
menuconfig HIPCIE
	bool "Hisilicon PCI Express support"
	depends on PCI && (ARCH_HI3519 || ARCH_HI3519V101 || ARCH_HI3559 || ARCH_HI3556 || ARCH_HI3516AV200)
	default y if PCI
	default n if ! PCI
	help
	Hisilicon PCI Express support
	Choose this selection to support PCI Express uses.

if HIPCIE

menu "PCI Express configs"

config PCIE0_SEL
        int "PCI Express controller 0 sel"
        range 0 1
        default "0" if ! PCI
        default "1" if PCI
        depends on PCI
        help
        PCI Express controller 0 sel.
        Set 0 to disable controller 0 as RC.
        set 1 to enable controller 0 to work at RC mode.

config PCIE0_DEVICES_MEM_SIZE
        hex "Total memory size of PCI Express EP devices"
        range 0x0 0x10000000 if ARCH_HI3519
        range 0x0 0x10000000 if ARCH_HI3519V101
        range 0x0 0x10000000 if ARCH_HI3516AV200
	range 0x0 0x10000000 if ARCH_HI3559
	range 0x0 0x10000000 if ARCH_HI3556
        default "0x8000000" if ARCH_HI3519
        default "0x8000000" if ARCH_HI3519V101
        default "0x8000000" if ARCH_HI3516AV200
	default "0x8000000" if ARCH_HI3559
	default "0x8000000" if ARCH_HI3556
        depends on PCI
        help
        Memory available for all pcie EP devices in pci subsystem.
        Hisilicon PCI Express controller provides up to 256MBytes address
	space for its subordinated devices.
	No IO address space is reserved, since to support PCI legacy devices
	which required IO address space.
        You can change this value as you please.

config PCIE0_DEVICES_CONFIG_SIZE
        hex "Sum of configuration header size mapped for all PCIe EP devices"
        range 0x0 0x10000000   if ARCH_HI3519
        range 0x0 0x10000000   if ARCH_HI3519V101
        range 0x0 0x10000000   if ARCH_HI3516AV200
	range 0x0 0x10000000   if ARCH_HI3559
	range 0x0 0x10000000   if ARCH_HI3556
        default 0x800000       if ARCH_HI3519
        default 0x800000       if ARCH_HI3519V101
        default 0x800000       if ARCH_HI3516AV200
	default 0x800000       if ARCH_HI3559
	default 0x800000       if ARCH_HI3556
        depends on PCI
        help
	As to the PCIe address space configuration, address space for all EPs
	is up to 256Mbytes. But, normally people do not used that much. Each
	EP device will use 4Kbytes virtual address space for PCIe configuration header.
	Normally people will not use that much(256MB).
	Enlarge this value will require more system virtual address space.
	The DEFAULT value(8MB) is enough for most applications.

config LIMIT_MAX_RD_REQ_SIZE
	bool "limit pcie max read request size"
	default y
	depends on PCI && (ARCH_HI3519 || ARCH_HI3519V101 || ARCH_HI3559 || ARCH_HI3556 || ARCH_HI3516AV200) 
	help
	The default max read request size of pcie device is 512 Byte. When pcie use
	the card of pcie-to-sata to connect to the sata disk, with the default max read
	request size value of 512 byte, would cause the low bandwidth of VDP. If you enable
	the LIMIT_MAX_RD_REQ_SIZE config, the max read request size of pcie device would be
	set to 128 byte, and the problem of VDP low band width also be avoided.

config PCIE1_SEL
	int "PCI Express controller 1 sel"
	range 0 1
	default "0"
	depends on PCI && ARCH_GODNET
	help
	PCI Express controller 1 sel.
	Set 0 to disable controller 1,
	set 1 to enable controller 1 to work at RC mode.

config PCIE1_DEVICES_MEM_SIZE
	hex "Total memory size of PCI Express EP devices"
	range 0x0 0x7800000 if PCIE1_SEL
	default "0x7800000" if PCIE1_SEL
	depends on PCI && PCIE1_SEL
	help
	All memory size required by all devices in pci subsystem.
	Hisilicon PCI Express controller provide up to 128M memory
	and io size for device.
	Here we set memory size up to 120M, means that io size has at least 8M
	You can change this depend on you device connected
	to Hisilicon PCI Express controller.

config PCIE1_DEVICES_CONFIG_SIZE
	hex "Total configuration header size of PCI Express system devices"
	range 0x0 0x10000000   if PCIE1_SEL
	default 0x800000       if PCIE1_SEL
	depends on PCI && PCIE1_SEL
	help
	All configuration size required by devices connnect to
	Hisilicon PCI Express controller.
	NOTE: This will alloc memory from kernel,
	enlarge this will require the same memory.
	The default value is enough for most applications.

endmenu

endif
```

## linux/linux-3.18.y/drivers/usb/gadget/udc/hiudc3/Kconfig
```kconfig
#
# hisilicon usb2 device controller version 3.00a
#

menuconfig HI_SS_DEVICE
	tristate "hisilicon usb3 device controller version 2.50a driver"
	default n
	select USB_GADGET_DUALSPEED
	select USB_GADGET_SELECTED
	help
	  hisilicon usb3 device controller version 3.00a.

if HI_SS_DEVICE

config HIUSB_XHCI_REG_BASE_ADDRESS
	hex "hiusb3dev system control register base address"
	default "0xf98a0000" if ARCH_S40
	default "0x60180000" if ARCH_GODBOX
	default "0x10180000" if ARCH_HI3519
	default "0x10180000" if ARCH_HI3519V101
	default "0x10180000" if ARCH_HI3559
	default "0x10180000" if ARCH_HI3556
	default "0x10180000" if ARCH_HI3516AV200

config HIUSB_XHCI_REG_BASE_ADDRESS_LEN
	hex "hiusb3dev system control register size length"
	default "0x10000" if ARCH_S40
	default "0x10000" if ARCH_GODBOX
	default "0x10000" if ARCH_HI3519
	default "0x10000" if ARCH_HI3519V101
	default "0x10000" if ARCH_HI3559
	default "0x10000" if ARCH_HI3556
	default "0x10000" if ARCH_HI3516AV200

config HIUSB_XHCI_IRQ_NUMBER
	int "hiusb3dev system control register interrupt number"
	default "100" if ARCH_S40
	default "103" if ARCH_GODBOX
	default "54" if ARCH_HI3519
	default "54" if ARCH_HI3519V101
	default "54" if ARCH_HI3559
	default "54" if ARCH_HI3556
	default "54" if ARCH_HI3516AV200
endif # HI_SS_DEVICE
```

## linux/linux-3.4.y/arch/arm/mach-hi3516a/Kconfig
```kconfig
menu "HI3516A board feature"

config MACH_HI3516A
	bool "Support hi3516a platform"
	select CPU_V7
	select ARM_GIC
	select ARM_TIMER_SP804
	help
	  Include support for the Hisilion HI3516A platform.
	  HI3516A support ARM CORTEX-A7 processer,
	  within a Generic Interrupt Controller.
	  Support DDR2 and DDR3.
choice
        prompt "CPU timer source"
        default HAVE_SP804_LOCAL_TIMER_HI3516A

config HAVE_SP804_LOCAL_TIMER_HI3516A
	bool "arm local timer from sp804"
	help
	  arm local timer from sp804.
	  if you choice sp804 as local timer,
	  please select HAVE_SP804_LOCAL_TIMER_HI3516A,
	  if you choice arm selt as local timer,
	  please select HAVE_ARM_LOCAL_TIMER.

config HAVE_ARM_LOCAL_TIMER_HI3516A
	bool "arm local timer from arm self"
	help
	  arm local timer from arm self.
	  if you choice sp804 as local timer,
	  please select HAVE_SP804_LOCAL_TIMER_HI3516A,
	  if you choice arm selt as local timer,
	  please select HAVE_ARM_LOCAL_TIMER.

endchoice
config DEFAULT_BUSCLK
	int "DEFAULT_BUSCLK"
	default "50000000"
	help
	  Default AHB clock rate

endmenu
```

## linux/linux-3.4.y/arch/arm/mach-hi3518ev200/Kconfig
```kconfig
menu "HI3518EV200 board feature"

config MACH_HI3518EV200
	bool "Support hi3518ev200 platform"
	select CPU_ARM926T
	select ARM_VIC
	select ARM_TIMER_SP804
	help
	  Include support for the Hisilion HI3518EV200 platform.
	  HI3518EV200 support ARM926T processer,
	  within a Generic Interrupt Controller.
	  Support DDR2 and DDR3.
choice
        prompt "CPU timer source"
        default HAVE_SP804_LOCAL_TIMER_HI3518EV200

config HAVE_SP804_LOCAL_TIMER_HI3518EV200
	bool "arm local timer from sp804"
	help
	  arm local timer from sp804.
	  if you choice sp804 as local timer,
	  please select HAVE_SP804_LOCAL_TIMER_HI3518EV200,
	  if you choice arm selt as local timer,
	  please select HAVE_ARM_LOCAL_TIMER.

config HAVE_ARM_LOCAL_TIMER_HI3518EV200
	bool "arm local timer from arm self"
	help
	  arm local timer from arm self.
	  if you choice sp804 as local timer,
	  please select HAVE_SP804_LOCAL_TIMER_HI3518EV200,
	  if you choice arm selt as local timer,
	  please select HAVE_ARM_LOCAL_TIMER.

endchoice
config DEFAULT_BUSCLK
	int "DEFAULT_BUSCLK"
	default "60000000"
	help
	  Default AHB clock rate

endmenu
```
