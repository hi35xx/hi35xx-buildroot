## linux/linux-3.18.y/drivers/mtd/nand/hifmc100/Kconfig
```kconfig
#
# hisilicon flash memory controller SPI nand device driver version 100
# drivers/mtd/nand/hifmc100/Kconfig
# add by hisilicon 2015.5.7
#

menuconfig HIFMC100_SPI_NAND
	tristate "Hisilicon Flash Memory Controller v100 SPI Nand device Support"
	depends on HIFMC
	depends on MTD_NAND
	depends on HIFMC_SPI_NAND
	default n if ARCH_HI3516CV300
	default n if ARCH_HI3519
	default n if ARCH_HI3519V101
	default n if ARCH_HI3559
	default n if ARCH_HI3556
	default n if ARCH_HI3536C
	select MISC_FILESYSTEMS
	select MTD_BLOCK
	help
	  Hisilicon Flash Memory Controller device version 100 driver Support
	  Hisilicon Flash Memory Controller version 100 is called hifmc100 for
	  short. The controller driver support registers and DMA transfers
	  while reading or writing the SPI nand flash.

if HIFMC100_SPI_NAND

config SPI_NAND_MAX_CHIP_NUM
	int "Support max number of SPI Nand flash chip (1, 2)"
	default 1 if ARCH_HI3516CV300
	default 1 if ARCH_HI3519
	default 1 if ARCH_HI3519V101
	default 1 if ARCH_HI3559
	default 1 if ARCH_HI3556
	default 1 if ARCH_HI3536C
	help
	  flash memory controller v100 device only support 1 or 2 SPI nand flash
	  chip, your should not config other value.

choice
	prompt "Page Size and Ecc Type Select"
	default HIFMC100_AUTO_PAGESIZE_ECC if ARCH_HI3516CV300
	default HIFMC100_AUTO_PAGESIZE_ECC if ARCH_HI3519
	default HIFMC100_AUTO_PAGESIZE_ECC if ARCH_HI3519V101
	default HIFMC100_AUTO_PAGESIZE_ECC if ARCH_HI3559
	default HIFMC100_AUTO_PAGESIZE_ECC if ARCH_HI3556
	default HIFMC100_AUTO_PAGESIZE_ECC if ARCH_HI3536C

config HIFMC100_HARDWARE_PAGESIZE_ECC
	bool "Hardware"
	help
	  the configure of page size and ecc type lie on switch on the board.
	  so the page size and ecc type is controlled by Hardware see demo
	  board of SOC.

config HIFMC100_AUTO_PAGESIZE_ECC
	bool "Auto"
	help
	  auto-sensed the page size and ecc type value. driver will try each of
	  page size and ecc type one by one till flash can be read and wrote
	  accurately. so the page size and ecc type is match adaptively without
	  switch on the board

config HIFMC100_PAGESIZE_AUTO_ECC_NONE
	bool "Pagesize Auto, Ecc None"
	help
	  auto-sensed the page size and select ecc none. driver will try each
	  of page size one by one till flash can be read and wrote accurately.
	  so the page size is match adaptively without switch on the board

endchoice

endif # End of HIFMC100_SPI_NAND
```

## linux/linux-3.18.y/drivers/mtd/nand/hifmc100_nand/Kconfig
```kconfig
#
# drivers/mtd/nand/hifmc100_nand/Kconfig
# add by hisilicon 2015.5.7
#

menuconfig HIFMC100_NAND
	tristate "Hisilicon Flash Memory Controller v100 Nand device Support"
	depends on HIFMC
	depends on MTD_NAND
	default n if ARCH_HI3519
	default n if ARCH_HI3519V101
	default n if ARCH_HI3559
	default n if ARCH_HI3556
	select MISC_FILESYSTEMS
	select MTD_BLOCK
	help
	  Hisilicon Flash Memory Controller device version 100 driver Support
	  Hisilicon Flash Memory Controller version 100 is called hifmc100 for
	  short. The controller support DMA transfers while reading or writing
	  the Nand flash.

if HIFMC100_NAND

config HIFMC100_MAX_NAND_CHIP
	int "number of Nand flash chip (1, 2)"
	default 1 if ARCH_HI3519
	default 1 if ARCH_HI3519V101
	default 1 if ARCH_HI3559
	default 1 if ARCH_HI3556
	help
	  flash memory controller v100 device only support 1 or 2 Nand flash
	  chip, your should not config other value.

config HIFMC100_NAND_EDO_MODE
	bool "the Extended Data Out(EDO) mode"
	help
	  In Extended data out (EDO), a new data cycle is started while the data
	  output of the previous cycle is still active. This process of cycle
	  overlapping, called pipelining, increases processing speed by about
	  10 nanoseconds per cycle,increasing computer performance by about 5
	  percent compared to performance using FMP.

config RW_H_WIDTH
	int "the width of Read/Write HIGH Hold Time (0 to 15)"
	range 0 15
	default 10 if ARCH_HI3519
	default 10 if ARCH_HI3519V101
	default 10 if ARCH_HI3559
	default 10 if ARCH_HI3556
	help
	  the Read/Write HIGH Hold Time of nand flash

config R_L_WIDTH
	int "the Read pulse width (0 to 15)"
	range 0 15
	default 10 if ARCH_HI3519
	default 10 if ARCH_HI3519V101
	default 10 if ARCH_HI3559
	default 10 if ARCH_HI3556
	help
	  the Read/Write LOW Hold Time of nand flash

config W_L_WIDTH
	int "the Write pulse width (0 to 15)"
	range 0 15
	default 10 if ARCH_HI3519
	default 10 if ARCH_HI3519V101
	default 10 if ARCH_HI3559
	default 10 if ARCH_HI3556
	help
	  the Read/Write LOW Hold Time of nand flash

choice
	prompt "Page Size and Ecc Type Select"
	default HIFMC100_NAND_AUTO_PAGESIZE_ECC if ARCH_HI3519
	default HIFMC100_NAND_AUTO_PAGESIZE_ECC if ARCH_HI3519V101
	default HIFMC100_NAND_AUTO_PAGESIZE_ECC if ARCH_HI3559
	default HIFMC100_NAND_AUTO_PAGESIZE_ECC if ARCH_HI3556

config HIFMC100_NAND_HARDWARE_PAGESIZE_ECC
	bool "Hardware"
	help
	  the configure of page size and ecc type lie on switch on the board.
	  so the page size and ecc type is controlled by Hardware see demo
	  board of SOC.

config HIFMC100_NAND_AUTO_PAGESIZE_ECC
	bool "Auto"
	help
	  auto-sensed the page size and ecc type value. driver will try each of
	  page size and ecc type one by one till flash can be read and wrote
	  accurately. so the page size and ecc type is match adaptively without
	  switch on the board

config HIFMC100_NAND_PAGESIZE_AUTO_ECC_NONE
	bool "Pagesize Auto, Ecc None"
	help
	  auto-sensed the page size and select ecc none. driver will try each
	  of page size one by one till flash can be read and wrote accurately.
	  so the page size is match adaptively without switch on the board

endchoice

endif # End of HIFMC100_NAND
```

## linux/linux-3.18.y/drivers/net/ethernet/hisilicon/Kconfig
```kconfig
#
# HISILICON device configuration
#

config NET_VENDOR_HISILICON
	bool "Hisilicon devices"
	default y
	depends on ARM
	---help---
	  If you have a network (Ethernet) card belonging to this class, say Y
	  and read the Ethernet-HOWTO, available from
	  <http://www.tldp.org/docs.html#howto>.

	  Note that the answer to this question doesn't directly affect the
	  kernel: saying N will just cause the configurator to skip all
	  the questions about Hisilicon devices. If you say Y, you will be asked
	  for your specific card in the following questions.

if NET_VENDOR_HISILICON

config HIX5HD2_GMAC
	tristate "Hisilicon HIX5HD2 Family Network Device Support"
	select PHYLIB
	help
	  This selects the hix5hd2 mac family network device.

config HISI_FEMAC
	tristate "Hisilicon Fast Ethernet MAC device support"
	depends on HAS_IOMEM
	select PHYLIB
	select RESET_CONTROLLER
	help
	  This selects the Hisilicon Fast Ethernet MAC device(FEMAC).
	  The FEMAC receives and transmits data over Ethernet
	  ports at 10/100 Mbps in full-duplex or half-duplex mode.
	  The FEMAC exchanges data with the CPU, and supports
	  the energy efficient Ethernet (EEE).

source "drivers/net/ethernet/hisilicon/higmac/Kconfig"
source "drivers/net/ethernet/hisilicon/hieth/Kconfig"

endif # NET_VENDOR_HISILICON
```

## linux/linux-3.18.y/drivers/net/ethernet/hisilicon/hieth/Kconfig
```kconfig
#
# hieth family network device configuration
#

menuconfig HIETH_SWITCH_FABRIC
	tristate "hieth(switch fabric) family network device support"
	select PHYLIB
	select RESET_CONTROLLER
	help
	  This selects the hieth family network device.
	  The hieth switch fabric (SF) receives and transmits data over two Ethernet
	  ports at 10/100 Mbit/s in full-duplex or half-duplex mode.
	  The Ethernet port exchanges data with the CPU port, and supports
	  the energy efficient Ethernet (EEE).

if HIETH_SWITCH_FABRIC

config HIETH_MAX_RX_POOLS
	int "hieth max rx pool size"
	default "1024"
	help
	  hieth max static rx pool size.

config TX_FLOW_CTRL_SUPPORT
	bool "tx flow ctrl supported"
	default y
	help
	  Tx flow ctrl supported, default is enabled.
	  When we has no buffer to receive packet,
	  we will send pause frame.
	  Rx flow ctrl default is enabled, cannot be disabled.

config TX_FLOW_CTRL_ACTIVE_THRESHOLD
	int "tx flow ctrl active threshold"
	default "3"
	range 1 31
	help
	  The threshold for activing tx flow ctrl.
	  When the left amount of receive queue descriptors is below this threshold,
	  hardware will send pause frame immediately.
	  We advise this value is set between 1 and 10. Too bigger is not a good choice.
	  This value must be smaller than tx flow ctrl deactive threshold.

config TX_FLOW_CTRL_DEACTIVE_THRESHOLD
	int "tx flow ctrl deactive threshold"
	default "5"
	range 1 31
	help
	  The threshold for deactiving tx flow ctrl.
	  When the left amount of receive queue descriptors is above or equal with this threshold,
	  hardware will exit flow control state.
	  We advise this value is set between 1 and 10. Too bigger is not a good choice.
	  This value must be larger than tx flow ctrl active threshold.

endif # HIETH_SWITCH_FABRIC

#vim: set ts=8 sw=8 tw=78:
```

## linux/linux-3.18.y/drivers/net/ethernet/hisilicon/higmac/Kconfig
```kconfig
#
# higmac family network device configuration
#

menuconfig HIETH_GMAC
	tristate "hieth gmac family network device support"
	select PHYLIB
	select RESET_CONTROLLER
	help
	  This selects the hieth gmac family network device.
	  The gigabit switch fabric (GSF) receives and transmits data over Ethernet
	  ports at 10/100/1000 Mbit/s in full-duplex or half-duplex mode.
	  The Ethernet port exchanges data with the CPU port, and supports
	  the energy efficient Ethernet (EEE) and wake on LAN (WoL) functions.

if HIETH_GMAC

config HIGMAC_DESC_4WORD
        bool "higmac descriptor size is 4 words"
        default y
        help
	  This define the size of higmac descriptor structure.
	  In the newest version, descriptor size is 4 words.
	  But in some old version, the size is 8 words.
	  The default value is true.

config HIGMAC_RXCSUM
        bool "higmac Receive checksumming offload supported"
        default y
        help
	  This indicate MAC support Receive checksumming offload.
	  Support IPv4 and IPv6, tcp and udp.
	  The default value is enabled.
	  If old version MAC does not support, disable this option please.

config RX_FLOW_CTRL_SUPPORT
	bool "rx flow ctrl supported"
	default y
	help
	  Rx flow ctrl supported, default is enabled.
	  When we received pause frame,
	  we will stop transmiting data frame for some time.
	  The stopping time is the time filled in pause frame.

config TX_FLOW_CTRL_SUPPORT
	bool "tx flow ctrl supported"
	default y
	help
	  Tx flow ctrl supported, default is enabled.
	  When we has no buffer to receive packet,
	  we will send pause frame.
	  When buffer is available, we will send zero-quanta pause frame.

config TX_FLOW_CTRL_PAUSE_TIME
	hex "tx flow ctrl pause time"
	default "0xFFFF"
	help
	  The pause time filled in the sending pause frame.
	  The unit is the time for transmiting 512 bit data.
	  This value is 16 bit, so its value is 0x0000~0xFFFF.
	  The default value is 0xFFFF.

config TX_FLOW_CTRL_PAUSE_INTERVAL
	hex "tx flow ctrl pause interval"
	default "0xFFFF"
	help
	  The interval time for sending pause frame.
	  When the remainint amount of receive queue is below tx flow ctrl active threshold,
	  we will wait this time to transmiting pause frame.
	  The unit is the time for transmiting 512 bit data.
	  This value is 16 bit, so its value is 0x0000~0xFFFF.
	  The default value is 0xFFFF.

config TX_FLOW_CTRL_ACTIVE_THRESHOLD
	int "tx flow ctrl active threshold"
	default "16"
	range 1 127
	help
	  The threshold for activing tx flow ctrl.
	  When the left amount of receive queue descriptors is below this threshold,
	  hardware will send pause frame immediately.
	  We advise this value is set smaller than 64. Too bigger is not a good choice.
	  This value must be smaller than tx flow ctrl deactive threshold.

config TX_FLOW_CTRL_DEACTIVE_THRESHOLD
	int "tx flow ctrl deactive threshold"
	default "32"
	range 1 127
	help
	  The threshold for deactiving tx flow ctrl.
	  When the left amount of receive queue descriptors is above or equal with this threshold,
	  hardware will exit flow control state.
	  We advise this value is set smaller than 64. Too bigger is not a good choice.
	  This value must be larger than tx flow ctrl active threshold.

endif # HIETH_GMAC
```
