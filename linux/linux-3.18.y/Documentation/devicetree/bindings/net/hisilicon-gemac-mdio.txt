## linux/linux-3.18.y/Documentation/devicetree/bindings/net/hisilicon-gemac-mdio.txt
```
Hisilicon Gigabit Ethernet MDIO Controller interface

Required properties:
- compatible: should be "hisilicon,hisi-gemac-mdio".
- reg: address and length of the register set for the device.
- clocks: A phandle to the reference clock for this device.

- PHY subnode: inherits from phy binding [1]
[1] Documentation/devicetree/bindings/net/phy.txt

Example:
mdio: mdio@100503c0 {
	compatible = "hisilicon,hisi-gemac-mdio";
	reg = <0x100503c0 0x20>;
	clocks = <&crg HI3519V100_MDIO_CLK>;
	#address-cells = <1>;
	#size-cells = <0>;

	phy0: phy@1 {
		reg = <1>;
	};
};
```

## linux/linux-3.18.y/Documentation/devicetree/bindings/net/hisilicon-hieth.txt
```
Hisilicon hieth controller

Required properties:
- compatible: should be "hisilicon,hieth".
- reg: specifies base physical address(s) and size of the device registers.
  The region is the MAC register base and size.
- interrupts: should contain the MAC interrupt.
- #address-cells: must be <1>.
- #size-cells: must be <0>.
- phy-mode: see ethernet.txt [1].
- phy-handle: see ethernet.txt [1].
- mac-address: see ethernet.txt [1].
- clocks: clock phandle and specifier pair.
- resets: reset controller phandle and specifier pair.

- PHY subnode: inherits from phy binding [2]

[1] Documentation/devicetree/bindings/net/ethernet.txt
[2] Documentation/devicetree/bindings/net/phy.txt

Example:
	hieth: ethernet@10050000 {
		compatible = "hisilicon,hieth";
		reg = <0x10050000 0x4000>;
		interrupts = <12>;

		clocks = <&clock HI3516CV300_ETH_CLK>;
		clock-names = "clk";

		resets = <&clock 0xcc 0>,
				<&clock 0xcc 3>;
		reset-names = "mac_reset",
				"phy0_reset";

		phy-handle = <&hieth_phy0>;

		#address-cells = <1>;
		#size-cells = <0>;

		hieth_phy0: hieth_phy@1 {
			reg = <1>;
			mac-address = [00 00 00 00 00 00];
			phy-mode = "mii";
		};
	};
```

## linux/linux-3.18.y/Documentation/devicetree/bindings/net/hisilicon-higmac.txt
```
Hisilicon higmac controller

Required properties:
- compatible: should be "hisilicon,higmac" and one of the following:
	- "hisilicon,higmac-v1"
	- "hisilicon,higmac-v2"
	- "hisilicon,higmac-v3"
	- "hisilicon,higmac-v4"
	- "hisilicon,higmac-v5"
- reg: specifies base physical address(s) and size of the device registers.
  The first region is the MAC register base and size.
  The second region is external interface control register.
- interrupts: should contain the MAC interrupt.
- #address-cells: must be <1>.
- #size-cells: must be <0>.
- phy-mode: see ethernet.txt [1].
- phy-handle: see ethernet.txt [1].
- mac-address: see ethernet.txt [1].
- clocks: clock phandle and specifier pair.
- resets: reset controller phandle and specifier pair.

- PHY subnode: inherits from phy binding [2]

[1] Documentation/devicetree/bindings/net/ethernet.txt
[2] Documentation/devicetree/bindings/net/phy.txt

Example:
	higmac: ethernet@10050000 {
		compatible = "hisilicon,higmac";
		reg = <0x10050000 0x1000>,<0x120100ec 0x4>;
		interrupts = <0 25 4>;
		#address-cells = <1>;
		#size-cells = <0>;
		phy-mode = "rgmii";
		phy-handle = <&eth_phy>;
		mac-address = [00 00 00 00 00 00];
		clocks = <&clock HI3519_ETH_CLK>,
				<&clock HI3519_ETH_MACIF_CLK>;
		clock-names = "higmac_clk",
				"macif_clk";

		resets = <&clock 0xcc 0>,
				<&clock 0xcc 2>,
				<&clock 0xcc 7>;
		reset-names = "port_reset",
				"macif_reset",
				"phy_reset";

		eth_phy: ethernet-phy@1 {
			reg = <1>;
		};
	};
```

## linux/linux-3.18.y/Documentation/devicetree/bindings/phy/hisi-sata-nano-phy.txt
```
Hisilicon SATA NANO PHY
-----------------------

Required properties:
- compatible: should be "hisilicon,hisi-sata-nano-phy"
- reg: offset and length of the PHY registers
- #phy-cells: must be 0
Refer to phy/phy-bindings.txt for the generic PHY binding properties

Optional Properties:
- hisilicon,peripheral-syscon: phandle of syscon used to control peripheral.
- hisilicon,power-reg: offset and bit number within peripheral-syscon,
	register of controlling sata power supply.

Example:
	sata_phy: phy@f9900000 {
		compatible = "hisilicon,hisi-sata-nano-phy";
		reg = <0xf9900000 0x10000>;
		#phy-cells = <0>;
		hisilicon,peripheral-syscon = <&peripheral_ctrl>;
		hisilicon,power-reg = <0x8 10>;
	};
```

## linux/linux-3.18.y/Documentation/devicetree/bindings/phy/hisi-usb-phy.txt
```
Hisilicon hi3519 USB2 PHY
-----------------------

Required properties:
- compatible: should be "hisilicon,hisi-usb-phy"
- reg: offset and length of the PHY registers
- #phy-cells: must be 0
Refer to phy/phy-bindings.txt for the generic PHY binding properties

Example:
	usb_phy: phy {
		compatible = "hisilicon,hisi-usb-phy";
		reg = <0x12030000 0x10000>, <0x12010000 0x10000>;
		#phy-cells = <0>;
	};
```

## linux/linux-3.18.y/Documentation/devicetree/bindings/phy/hisi-usb3-phy.txt
```
Hisilicon hi3519 USB3 PHY
-----------------------

Required properties:
- compatible: should be "hisilicon,hisi-usb3-phy"
- reg: offset and length of the PHY registers
- #phy-cells: must be 0
Refer to phy/phy-bindings.txt for the generic PHY binding properties

Example:
	usb3_phy: phy {
		compatible = "hisilicon,hisi-usb3-phy";
		reg = <0x10180000 0x10000>, <0x12010000 0x10000>;
		#phy-cells = <0>;
	};
```

## linux/linux-3.18.y/Documentation/devicetree/bindings/phy/phy-hisi-inno-usb2.txt
```
HiSilicon INNO USB2 PHY
-----------------------
Required properties:
- compatible: Should be "hisilicon,inno_usb2_phy"
- #phy-cells: Must be 0
- hisilicon,peripheral-syscon: Phandle of syscon used to control phy.
- hisilicon,reg-num: Number of phy registers which should be configured
at phy intialization stage
- hisilicon,reg-seq: Sequence of triplets of (address, value, delay-us).
The number of triplets is equal to "hisilicon,reg-num". Each triplet is
used to write one phy register. The delay-us cell represents the delay
time in microseconds to be applied after each write.
- clocks: Phandle and clock specifier pair for reference clock utmi_refclk.
- resets: List of phandle and reset specifier pairs for each reset signal in
reset-names.
- reset-names: Should be "por_rst" and "test_rst". The test_rst only
exists in some of SOCs, so it is optional.

Phy node can includes up to four subnodes. Each subnode represents one port.
The required properties of port node are as follows:
- clocks: Phandle and clock specifier pair for utmi_clock.
- resets: List of phandle and reset specifier pairs for port reset and utmi reset.
- reset-names: List of reset signal names. Should be "port_rst" and "utmi_rst"

Refer to phy/phy-bindings.txt for the generic PHY binding properties

Example:
usb_phy: phy {
		 compatible = "hisilicon,inno_usb2_phy";
		 #phy-cells = <0>;
		 hisilicon,peripheral-syscon = <&peri_ctrl>;
		 hisilicon,reg-num = <7>;
		 hisilicon,reg-seq = <0x80 0x800000 20>,
			 <0x80 0xa0060c 200>,
			 <0x80 0x80001c 20>,
			 <0x80 0xa0001c 20>,
			 <0x80 0x80060f 20>,
			 <0x80 0xa0060f 20>,
			 <0x80 0x800a4b 20>;
		 clocks = <&crg USB2_REF_CLK>;
		 resets = <&crg 0xb4 2>;
		 reset-names = "por_rst";
		 port0 {
			 clocks = <&crg USB2_UTMI0_CLK>;
			 resets = <&crg 0xb4 5>, <&crg 0xb4 1>;
			 reset-names = "port_rst", "utmi_rst";
		 };
	 };
```

## linux/linux-3.18.y/Documentation/devicetree/bindings/pwm/pwm-hibvt.txt
```
Hisilicon PWM controller

Required properties:
-compatible: should contain one SoC specific compatible string and one generic compatible
string "hisilicon, hibvt-pwm". The SoC specific strings supported including:
	"hisilicon,hi3516cv300-pwm"
	"hisilicon,hi3519v100-pwm"
- reg: physical base address and length of the controller's registers.
- clocks: phandle and clock specifier of the PWM reference clock.
- resets: phandle and reset specifier for the PWM controller reset.

Example:
	pwm: pwm@12130000 {

		compatible = "hisilicon,hi3516cv300-pwm", "hisilicon,hibvt-pwm";
		compatible = "hisilicon,hi3519v100-pwm", "hisilicon,hibvt-pwm";
		reg = <0x12130000 0x10000>;
		clocks = <&crg_ctrl HI3516CV300_PWM_CLK>;
		resets = <&crg_ctrl 0x38 0>;
	};
```

## linux/linux-3.18.y/Documentation/devicetree/bindings/rtc/rtc-hibvt.txt
```
Hisilicon RTC controller

Required properties:
-compatible: should contain one SoC specific compatible string
The SoC specific strings supported including:
- compatible: "hisilicon,hi35xvr-rtc"
- reg: physical base address and length of the controller's registers.
- interrupts: IRQ line for the RTC.

Example:
rtc: rtc@120b0000 {
		 compatible = "hisilicon,hi35xvr-rtc";
		 reg = <0x120b0000 0x10000>;
		 interrupts = <0 5 4>;
	 };
```

## linux/linux-3.18.y/arch/arm/mach-hisi/Kconfig
```kconfig
config ARCH_HISI
	bool "Hisilicon SoC Support"
	select ARM_AMBA
	select ARM_GIC if ARCH_MULTI_V7
	select ARM_TIMER_SP804
	select POWER_RESET
	select POWER_RESET_HISI
	select POWER_SUPPLY

if ARCH_HISI

menu "Hisilicon platform type"

config ARCH_HI3xxx
	bool "Hisilicon Hi36xx family" if ARCH_MULTI_V7
	select CACHE_L2X0
	select HAVE_ARM_SCU if SMP
	select HAVE_ARM_TWD if SMP
	select PINCTRL
	select PINCTRL_SINGLE
	help
	  Support for Hisilicon Hi36xx SoC family

config ARCH_HIP04
	bool "Hisilicon HiP04 Cortex A15 family" if ARCH_MULTI_V7
	select ARM_ERRATA_798181 if SMP
	select HAVE_ARM_ARCH_TIMER
	select MCPM if SMP
	select MCPM_QUAD_CLUSTER if SMP
	help
	  Support for Hisilicon HiP04 SoC family

config ARCH_HIX5HD2
	bool "Hisilicon X5HD2 family" if ARCH_MULTI_V7
	select CACHE_L2X0
	select HAVE_ARM_SCU if SMP
	select HAVE_ARM_TWD if SMP
	select PINCTRL
	select PINCTRL_SINGLE
	help
	  Support for Hisilicon HIX5HD2 SoC family

config ARCH_HI3519
	bool "Hisilicon Hi3519 Cortex-a7.Cortex-a17 family" if ARCH_MULTI_V7
	select HAVE_ARM_ARCH_TIMER
	select ARM_CCI
	select ARCH_HAS_RESET_CONTROLLER
	select RESET_CONTROLLER
	select PM_OPP
	select PMC if SMP
	help
	  Support for Hisilicon Hi3519 Soc family

config ARCH_HI3519V101
	bool "Hisilicon Hi3519V101 Cortex-a7.Cortex-a17 family" if ARCH_MULTI_V7
	select HAVE_ARM_ARCH_TIMER
	select ARM_CCI
	select ARCH_HAS_RESET_CONTROLLER
	select RESET_CONTROLLER
	select PM_OPP
	select PMC if SMP
	help
	  Support for Hisilicon Hi3519V101 Soc family

config ARCH_HI3516AV200
	bool "Hisilicon Hi3516AV200 Cortex-a7.Cortex-a17 family" if ARCH_MULTI_V7
	select HAVE_ARM_ARCH_TIMER
	select ARM_CCI
	select ARCH_HAS_RESET_CONTROLLER
	select RESET_CONTROLLER
	select PM_OPP
	select PMC if SMP
	help
	  Support for Hisilicon Hi3516AV200 Soc family

config ARCH_HI3559
	bool "Hisilicon Hi3559 Cortex-a7.Cortex-a17 family" if ARCH_MULTI_V7
	select HAVE_ARM_ARCH_TIMER
	select ARM_CCI
	select ARCH_HAS_RESET_CONTROLLER
	select RESET_CONTROLLER
	select PM_OPP
	select PMC if SMP
	help
	  Support for Hisilicon Hi3559 Soc family

config ARCH_HI3556
	bool "Hisilicon Hi3556 Cortex-a7.Cortex-a17 family" if ARCH_MULTI_V7
	select HAVE_ARM_ARCH_TIMER
	select ARM_CCI
	select ARCH_HAS_RESET_CONTROLLER
	select RESET_CONTROLLER
	select PM_OPP
	select PMC if SMP
	help
	  Support for Hisilicon Hi3556 Soc family


if ARCH_HI3519 || ARCH_HI3519V101 || ARCH_HI3559 || ARCH_HI3556 || ARCH_HI3516AV200

config PMC
	bool
	help
	  support power control for Hi3519 or Hi3519V101 or Hi3516AV200 or HI3559 Cortex-a17 or HI3556 Cortex-a17

endif

config ARCH_HI3516CV300
	bool "Hisilicon Hi3516cv300 arm926ej-s family" if ARCH_MULTI_V5
	depends on ARCH_MULTI_V5
	select ARM_VIC
	select PINCTRL
	select PINCTRL_SINGLE
	help
	  Support for Hisilicon Hi3516cv300 Soc family

config ARCH_HI3536C
	bool "Hisilicon Hi3536C Cortex-a7 family" if ARCH_MULTI_V7
	select HAVE_ARM_ARCH_TIMER
	select ARM_GIC
	select ARCH_HAS_RESET_CONTROLLER
	select RESET_CONTROLLER
	select HAVE_ARM_SCU if SMP
	help
	  Support for Hisilicon Hi3536C Soc family

endmenu

endif
```

## linux/linux-3.18.y/drivers/ata/Kconfig.hiahci
```kconfig
menuconfig HI_SATA
	bool "hisilicon sata device support"
	depends on ARCH_HI3536C
	default y if ARCH_HI3536C
	select ATA
	select ATA_VERBOSE_ERROR
	select SATA_PMP
	select SATA_AHCI_PLATFORM

if HI_SATA
config HI_SATA_IOBASE
	hex "hi sata IO address"
	default "0x11010000" if ARCH_HI3536C
	help
	  hisilicon sata io base address.

config HI_SATA_FBS
	int "hi sata FIS-Based switching"
	default 1
	range 0 1
	help
	  Hisatav200 supports FBS.
	  FBS is FIS-Based switching.
	  Choose y if you want to use it.

config HI_SATA_NCQ
	int "hi sata Native Command Queuing"
	default 1
	range 0 1
	help
	  Hisatav200 supports NCQ.
	  NCQ is Native Command Queuing.
	  Choose y if you want to use it.

endif
```

## linux/linux-3.18.y/drivers/hidmac/Kconfig
```kconfig
#
# Sensor device configuration
#

config HI_DMAC
	tristate "Hisilicon DMAC Controller support"
	depends on (ARCH_HISI)
	help
	  The Direction Memory Access(DMA) is a high-speed data transfer
	  operation. It supports data read/write between peripherals and
	  memories without using the CPU.
	  Hisilicon DMA Controller(DMAC) directly transfers data between
	  a memory and a peripheral, between peripherals, or between memories.
	  This avoids the CPU intervention and reduces the interrupt handling
	  overhead of the CPU.

if HI_DMAC
config HI_DMAC_IO_BASE
	hex "hi dmac register base address"
	depends on ARCH_HI3519 || ARCH_HI3519V101 || ARCH_HI3559 || ARCH_HI3556 || ARCH_HI3516AV200
	default "0x10030000" if ARCH_HI3519 || ARCH_HI3519V101 || ARCH_HI3559 || ARCH_HI3556 || ARCH_HI3516AV200

config HI_DMAC_CHANNEL_NUM
	int "hi dmac channel num"
	default "4" if ARCH_HI3519 || ARCH_HI3519V101 || ARCH_HI3559 || ARCH_HI3556 || ARCH_HI3516AV200
	default "4" if ARCH_HI3516CV300
endif
```

## linux/linux-3.18.y/drivers/hisilicon/Kconfig
```kconfig
menu "Hisilicon driver support"

source "drivers/hisilicon/cma/Kconfig"

endmenu
```

## linux/linux-3.18.y/drivers/misc/hi_reg/Kconfig
```kconfig
menu "hisi 'himm/himd.l/himc'support"

config HISI_REG
	tristate "hisi \"himd\" \"himm\" \"himc\" support"
	default y if (ARCH_HI3519)
	default y if (ARCH_HI3519V101)
	help
	  This selects the Hisilicon io register access support
	  If you want use "himd" "himm" "himc" command,
	  Say Y or M here.

	  Default is Y.
endmenu
```

## linux/linux-3.18.y/drivers/mmc/host/himciv200/Kconfig
```kconfig
#
# himci v200 device configuration
#
menuconfig HIMCIV200
	tristate "himci v200 eMMC/SDXC/SDIO device support"
	depends on (ARCH_HI3516CV300 || ARCH_HI3519 || ARCH_HI3519V101 || ARCH_HI3559 || ARCH_HI3556 || ARCH_HI3516AV200)
	default y if (ARCH_HI3516CV300)
	default y if (ARCH_HI3519)
	default y if (ARCH_HI3519V101)
	default y if (ARCH_HI3516AV200)
	default y if (ARCH_HI3559)
	default y if (ARCH_HI3556)
	select MMC_UNSAFE_RESUME
	select MMC_EMBEDDED_SDIO
	select MMC_BLOCK
	select MMC_BLOCK_BOUNCE
	help
	  This selects the Hisilicon Synopsys MultiMedia Card Driver
	  support. If you want use SD/MMC/SDIO driver,
	  Say Y or M here.

	  default is Y.

config SEND_AUTO_STOP
	bool "Send Auto Stop to terminate data transfer between host and SD card"
	depends on (ARCH_HI3516CV300 || ARCH_HI3519 || ARCH_HI3519V101 || ARCH_HI3559 || ARCH_HI3556 || ARCH_HI3516AV200) && HIMCIV200
	default y

config DETECT_CARD_TIME
	int "The Period to detect whether Card is pluged or unpluged."
	depends on (ARCH_HI3516CV300 || ARCH_HI3519 || ARCH_HI3519V101 || ARCH_HI3559 || ARCH_HI3556 || ARCH_HI3516AV200) && HIMCIV200
	range 10 500
	default 200
	help
	  Set the Period Time to detect the card, which the unit is ms.
	  Should set it between 10 and 500.

	  Default is 200 here.
```
