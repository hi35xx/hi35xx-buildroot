## package/himpp/himpp-hi3520/Config.in
```kconfig
comment "Options for hi3520 mpp"

config BR2_PACKAGE_HIMPP_PREFIX
	string "Install prefix"
	default "/usr"
	help
	  Prefix to install himpp on the target file system.

menu "External kernel module & utils"

config BR2_PACKAGE_HIMPP_EXTDRV_ADV7179
	bool "adv7179"
	default y
	help
	  adv7179 video codec driver

config BR2_PACKAGE_HIMPP_EXTDRV_CIPHER
	bool "cipher"
	default y
	help
	  cipher driver

config BR2_PACKAGE_HIMPP_EXTDRV_GPIO_I2C
	bool "gpio-i2c"
	default n
	help
	  gpio-i2c bit-bang i2c driver

config BR2_PACKAGE_HIMPP_EXTDRV_I2C
	bool "i2c"
	default n
	help
	  i2c driver

config BR2_PACKAGE_HIMPP_EXTDRV_IRDA
	bool "hisi-irda"
	default n
	help
	  hisi-irda driver

config BR2_PACKAGE_HIMPP_EXTDRV_SIL9022
	bool "sil9022"
	default n
	help
	  sil9022 HDMI transmitter driver

config BR2_PACKAGE_HIMPP_EXTDRV_SSP_GV7601
	bool "ssp-gv7601"
	default n

config BR2_PACKAGE_HIMPP_EXTDRV_TLV320AIC31
	bool "tlv320aic31"
	default n

config BR2_PACKAGE_HIMPP_EXTDRV_NVP1918
	bool "nvp1918"
	default y
	depends on BR2_PACKAGE_HIMPP_EXTDRV_GPIO_I2C || \
		BR2_PACKAGE_HIMPP_EXTDRV_I2C
	help
	  nvp1918 video codec driver

config BR2_PACKAGE_HIMPP_EXTDRV_TW2865
	bool "tw2865"
	default y
	depends on BR2_PACKAGE_HIMPP_EXTDRV_GPIO_I2C || \
		BR2_PACKAGE_HIMPP_EXTDRV_I2C

config BR2_PACKAGE_HIMPP_EXTDRV_TW2868
	bool "tw2868"
	default y
	depends on BR2_PACKAGE_HIMPP_EXTDRV_GPIO_I2C || \
		BR2_PACKAGE_HIMPP_EXTDRV_I2C

config BR2_PACKAGE_HIMPP_EXTDRV_TW2960
	bool "tw2960"
	default y
	depends on BR2_PACKAGE_HIMPP_EXTDRV_GPIO_I2C || \
		BR2_PACKAGE_HIMPP_EXTDRV_I2C

endmenu

menuconfig BR2_PACKAGE_HIMPP_SAMPLES
	bool "Build MPP samples"
	default n
	help
	  Build samples for HiMPP for HI3520

if BR2_PACKAGE_HIMPP_SAMPLES

config BR2_PACKAGE_HIMPP_SAMPLES_AUDIO
	bool "audio"
	depends on BR2_PACKAGE_HIMPP_SAMPLES
	help
	  Build audio samples for hi3518

config BR2_PACKAGE_HIMPP_SAMPLES_HIFB
	bool "hifb"
	depends on BR2_PACKAGE_HIMPP_SAMPLES
	help
	  Build hifb samples for hi3518

config BR2_PACKAGE_HIMPP_SAMPLES_IQ
	bool "iq"
	depends on BR2_PACKAGE_HIMPP_SAMPLES
	help
	  Build iq samples for hi3518

config BR2_PACKAGE_HIMPP_SAMPLES_IVE
	bool "ive"
	depends on BR2_PACKAGE_HIMPP_SAMPLES
	help
	  Build ive samples for hi3518

config BR2_PACKAGE_HIMPP_SAMPLES_REGION
	bool "region"
	depends on BR2_PACKAGE_HIMPP_SAMPLES
	help
	  Build region samples for hi3518

config BR2_PACKAGE_HIMPP_SAMPLES_TDE
	bool "tde"
	depends on BR2_PACKAGE_HIMPP_SAMPLES
	help
	  Build tde samples for hi3518

config BR2_PACKAGE_HIMPP_SAMPLES_VDA
	bool "vda"
	depends on BR2_PACKAGE_HIMPP_SAMPLES
	help
	  Build vda samples for hi3518

config BR2_PACKAGE_HIMPP_SAMPLES_VENC
	bool "venc"
	depends on BR2_PACKAGE_HIMPP_SAMPLES
	help
	  Build venc samples for hi3518

config BR2_PACKAGE_HIMPP_SAMPLES_VIO
	bool "vio"
	depends on BR2_PACKAGE_HIMPP_SAMPLES
	help
	  Build vio samples for hi3518

endif #BR2_PACKAGE_HIMPP_SAMPLES
```

## package/himpp/himpp-hi3520dv200/Config.in
```kconfig
comment "Options for hi3520dv200 mpp"

config BR2_PACKAGE_HIMPP_PREFIX
	string "Install prefix"
	default "/usr"
	help
	  Prefix to install himpp on the target file system.
```

## package/live-streamer/Config.in
```kconfig
config BR2_PACKAGE_LIVE_STREAMER
	bool "live-streamer"
	depends on BR2_TOOLCHAIN_HAS_THREADS
	depends on BR2_USE_MMU # fork()
	depends on !BR2_STATIC_LIBS
	depends on BR2_INSTALL_LIBSTDCPP
	select BR2_PACKAGE_LIBEV
	select BR2_PACKAGE_DBUS
	select BR2_PACKAGE_DBUS_CPP
	select BR2_PACKAGE_LIVE555
	help
	  live-streamer is a RTP/RTSP stream server, provide D-Bus
	  control interface. support hi3518 SoC.

	  https://github.com/hi35xx/live-streamer

comment "live-streamer needs a toolchain w/ threads, dynamic library"
	depends on !BR2_TOOLCHAIN_HAS_THREADS || BR2_STATIC_LIBS
	depends on BR2_USE_MMU
```

## package/live555/Config.in
```kconfig
comment "live555 needs a toolchain w/ C++"
	depends on !BR2_INSTALL_LIBSTDCPP

config BR2_PACKAGE_LIVE555
	bool "live555"
	depends on BR2_INSTALL_LIBSTDCPP
	help
	  LIVE555 Streaming Media forms a set of C++ libraries for multimedia
	  streaming, using open standard protocols (RTP/RTCP, RTSP, SIP).

	  http://www.live555.com/liveMedia/

if BR2_PACKAGE_LIVE555

config BR2_PACKAGE_LIVE555_MEDIA_SERVER
	bool "live555MediaServer"
	default y
	help
	  Install live555MediaServer

config BR2_PACKAGE_LIVE555_PROXY_SERVER
	bool "live555ProxyServer"
	default y
	help
	  Install live555ProxyServer

config BR2_PACKAGE_LIVE555_TEST_PROGS
	bool "live555 test programs"
	default n
	help
	  Install live555 test programs

endif # BR2_PACKAGE_LIVE555
```

## package/mt7601u/Config.in
```kconfig
config BR2_PACKAGE_MT7601U
    bool "mt7601u"
    select BR2_LINUX_KERNEL_EXT_WIFI
    select BR2_PACKAGE_WPA_SUPPLICANT
    select BR2_PACKAGE_WPA_SUPPLICANT_AP_SUPPORT
    select BR2_PACKAGE_WPA_SUPPLICANT_AUTOSCAN
    select BR2_PACKAGE_WPA_SUPPLICANT_EAP
    select BR2_PACKAGE_WPA_SUPPLICANT_HOTSPOT
    select BR2_PACKAGE_WPA_SUPPLICANT_WPS
    select BR2_PACKAGE_WPA_SUPPLICANT_CLI
    select BR2_PACKAGE_WPA_SUPPLICANT_WIFI_DISPLAY
    select BR2_PACKAGE_WPA_SUPPLICANT_MESH_NETWORKING
    help
    	Ralink 802.11n Wireless LAN USB-Card Linux driver.

config BR2_PACKAGE_MT7601U_PREFIX
    string "Install prefix"
    default "/usr"
    help
      Prefix to install mt7601u on the target file system.

config BR2_PACKAGE_WPA_DEFAULT_SSID
    string "Default wifi SSID"
    default "XXXXX"
    help
      Define local SSID for connect wpa_supplicant to WIFI AP


config BR2_PACKAGE_WPA_DEFAULT_PASSWORD
    string "Default wifi pass"
    default "XXXXX"
    help
      Define password for connect wpa_supplicant to WIFI AP
```

## package/rtl8188eu/Config.in
```kconfig
config BR2_PACKAGE_RTL8188EU
	bool "rtl8188eu"
	depends on BR2_LINUX_KERNEL
	help
	  A standalone driver for the RTL8188EU USB Wi-Fi adapter.
	  it is based on the realtek official driver.

	  https://github.com/hi35xx/rtl8188eu

if BR2_PACKAGE_RTL8188EU

config BR2_PACKAGE_RTL8188EU_CFG80211
	bool "Enable cfg80211 support"
	default y
	help
	  Enable support for cfg80211 support. This is the current wireless
	  API for Linux.

config BR2_PACKAGE_RTL8188EU_CONCURRENT_MODE
	bool "Enable concurrent mode"
	default n
	help
	  Realtek's Linux WiFi driver can support Station+AP and Station+P2P
	  single channel concurrent mode.

config BR2_PACKAGE_RTL8188EU_WIFI_MONITOR
	bool "Enable WiFi monitor"
	default n
	help
	  Enable monitor mode to sniffer packets in the air.

endif

comment "rtl8188eu needs a Linux kernel to be built"
	depends on !BR2_LINUX_KERNEL
```

## package/simpledbus/Config.in
```kconfig
config BR2_PACKAGE_SIMPLEDBUS
	bool "simpledbus"
	depends on BR2_PACKAGE_HAS_LUAINTERPRETER
	help
	  SimpleDBus is a Lua library which enables you to write
	  simple scripts to act on signals, send signals, call methods
	  on remote objects and export your own objects to DBus.

	  SimpleDBus implements a simple poll()-based main loop
	  so scripts can act asynchronously over several busses
	  at the same time.
```

## package/snapshotd/Config.in
```kconfig
config BR2_PACKAGE_SNAPSHOTD
	bool "snapshotd"
	select BR2_PACKAGE_LIVE555
	help
	  utility to take snapshot form RTSP JPEG stream.
```

## package/usbgpio/Config.in
```kconfig
config BR2_PACKAGE_USBGPIO
	bool "usbgpio"
	select BR2_PACKAGE_LIBUSB
	select BR2_PACKAGE_LIBUSB_COMPAT
	help
	  Utils for talk with USB GPIO
```

## package/wsapi-fcgi/Config.in
```kconfig
config BR2_PACKAGE_WSAPI_FCGI
	bool "wsapi-fcgi"
	# Runtime dependency only
	select BR2_PACKAGE_FCGI
	select BR2_PACKAGE_COXPCALL
	select BR2_PACKAGE_LUAFILESYSTEM
	select BR2_PACKAGE_RINGS
	select BR2_PACKAGE_WSAPI
	help
	  API that abstracts the web server from Lua web applications.

	  http://keplerproject.github.com/wsapi/
```
