## configs/hi3516ev300_defconfig
```kconfig
BR2_arm=y
BR2_cortex_a7=y
BR2_ARM_EABI=y
BR2_ARM_FPU_NEON_VFPV4=y
BR2_ENABLE_DEBUG=y
BR2_GLOBAL_PATCH_DIR="board/hisilicon/hi3516ev200/patches"
BR2_PACKAGE_HOST_LINUX_HEADERS_CUSTOM_4_9=y
BR2_TOOLCHAIN_BUILDROOT_WCHAR=y
BR2_PTHREAD_DEBUG=y
BR2_TOOLCHAIN_BUILDROOT_USE_SSP=y
# BR2_UCLIBC_INSTALL_UTILS is not set
BR2_GCC_VERSION_9_X=y
BR2_TOOLCHAIN_BUILDROOT_CXX=y
BR2_GCC_ENABLE_LTO=y
BR2_GCC_ENABLE_GRAPHITE=y
BR2_PACKAGE_HOST_GDB=y
BR2_PACKAGE_HOST_GDB_TUI=y
BR2_GDB_VERSION_8_3=y
BR2_TARGET_GENERIC_HOSTNAME="hi35xx"
BR2_TARGET_GENERIC_ISSUE="Welcome to hi35xx-buildroot"
BR2_ROOTFS_DEVICE_CREATION_DYNAMIC_EUDEV=y
BR2_ROOTFS_OVERLAY="board/hisilicon/hi3516ev200/fs-overlay"
BR2_LINUX_KERNEL=y
BR2_LINUX_KERNEL_CUSTOM_VERSION=y
BR2_LINUX_KERNEL_CUSTOM_VERSION_VALUE="4.9.37"
BR2_LINUX_KERNEL_USE_CUSTOM_CONFIG=y
BR2_LINUX_KERNEL_CUSTOM_CONFIG_FILE="board/hisilicon/hi3516ev200/linux-4.9.config"
BR2_LINUX_KERNEL_UIMAGE=y
BR2_LINUX_KERNEL_XZ=y
BR2_PACKAGE_BUSYBOX_CONFIG="board/hisilicon/hi3516ev200/busybox.config"
BR2_PACKAGE_LIVE_STREAMER=y
BR2_PACKAGE_BITSTREAM_VERA=y
BR2_PACKAGE_HIMPP=y
BR2_PACKAGE_HIMPP_HI3516EV200=y
BR2_PACKAGE_HIMPP_HI3516EV200_BOARD_HI3516EV300=y
BR2_PACKAGE_UBOOT_TOOLS=y
BR2_PACKAGE_LUAJIT=y
BR2_PACKAGE_LUA_PERIPHERY=y
BR2_PACKAGE_SIMPLEDBUS=y
BR2_PACKAGE_JSONCPP=y
BR2_TARGET_ROOTFS_SQUASHFS=y
BR2_TARGET_ROOTFS_SQUASHFS4_XZ=y
BR2_TARGET_ROOTFS_TAR_XZ=y
BR2_TARGET_UBOOT=y
BR2_TARGET_UBOOT_BUILD_SYSTEM_KCONFIG=y
BR2_TARGET_UBOOT_CUSTOM_VERSION=y
BR2_TARGET_UBOOT_CUSTOM_VERSION_VALUE="2016.11"
BR2_TARGET_UBOOT_BOARD_DEFCONFIG="hi3516ev300"
BR2_TARGET_UBOOT_HI35XX_IMAGE=y
BR2_TARGET_UBOOT_HI35XX_IMAGE_CH_SIZE=8192
BR2_TARGET_UBOOT_HI35XX_IMAGE_CH_FILE="board/hisilicon/hi3516ev200/boot/reg_info_hi3516ev300.bin"
BR2_TARGET_UBOOT_ENVIMAGE=y
BR2_TARGET_UBOOT_ENVIMAGE_SOURCE="board/hisilicon/hi3516ev200/uboot-env.txt"
BR2_TARGET_UBOOT_ENVIMAGE_SIZE="0x40000"
```

## configs/hi3518_defconfig
```kconfig
BR2_arm=y
BR2_ENABLE_DEBUG=y
BR2_KERNEL_HEADERS_VERSION=y
BR2_DEFAULT_KERNEL_VERSION="3.0.8"
BR2_PACKAGE_HOST_LINUX_HEADERS_CUSTOM_3_0=y
BR2_TOOLCHAIN_BUILDROOT_INET_RPC=y
BR2_TOOLCHAIN_BUILDROOT_WCHAR=y
BR2_PTHREAD_DEBUG=y
BR2_TOOLCHAIN_BUILDROOT_USE_SSP=y
# BR2_UCLIBC_INSTALL_UTILS is not set
BR2_GCC_VERSION_5_X=y
BR2_TOOLCHAIN_BUILDROOT_CXX=y
BR2_GCC_ENABLE_LTO=y
BR2_GCC_ENABLE_GRAPHITE=y
BR2_PACKAGE_HOST_GDB=y
BR2_PACKAGE_HOST_GDB_TUI=y
BR2_GDB_VERSION_7_10=y
BR2_TARGET_GENERIC_HOSTNAME="ipcam"
BR2_TARGET_GENERIC_ISSUE="Welcome to IPCAM"
BR2_ROOTFS_DEVICE_CREATION_DYNAMIC_MDEV=y
# BR2_TARGET_GENERIC_REMOUNT_ROOTFS_RW is not set
BR2_LINUX_KERNEL=y
BR2_LINUX_KERNEL_CUSTOM_LOCAL=y
BR2_LINUX_KERNEL_CUSTOM_LOCAL_PATH="linux/linux-3.0.y"
BR2_LINUX_KERNEL_USE_CUSTOM_CONFIG=y
BR2_LINUX_KERNEL_CUSTOM_CONFIG_FILE="board/hisilicon/hi3518/linux-3.0.config"
BR2_PACKAGE_BUSYBOX_CONFIG="board/hisilicon/hi3518/busybox.config"
BR2_PACKAGE_LIVE_STREAMER=y
BR2_PACKAGE_DBUS=y
BR2_PACKAGE_HIMPP=y
BR2_PACKAGE_HIMPP_EXTDRV_HI_I2C=y
BR2_PACKAGE_HIMPP_EXTDRV_PWM=y
BR2_PACKAGE_HIMPP_EXTDRV_SSP_AD9020=y
BR2_PACKAGE_HIMPP_EXTDRV_SSP_PANA=y
BR2_PACKAGE_HIMPP_EXTDRV_SSP_SONY=y
BR2_PACKAGE_HIMPP_EXTDRV_TW2865=y
# BR2_PACKAGE_LIVE555_MEDIA_SERVER is not set
# BR2_PACKAGE_LIVE555_PROXY_SERVER is not set
BR2_TARGET_ROOTFS_SQUASHFS=y
BR2_TARGET_ROOTFS_SQUASHFS4_XZ=y
BR2_TARGET_ROOTFS_TAR_XZ=y
BR2_TARGET_UBOOT=y
BR2_TARGET_UBOOT_BOARDNAME="hi3518e"
BR2_TARGET_UBOOT_CUSTOM_LOCAL=y
BR2_TARGET_UBOOT_CUSTOM_LOCAL_PATH="boot/uboot/u-boot-2010.06"
```

## configs/hi3518v200_defconfig
```kconfig
BR2_arm=y
BR2_CCACHE=y
BR2_ENABLE_DEBUG=y
BR2_PACKAGE_HOST_LINUX_HEADERS_CUSTOM_3_4=y
BR2_TOOLCHAIN_BUILDROOT_WCHAR=y
BR2_PTHREAD_DEBUG=y
BR2_TOOLCHAIN_BUILDROOT_USE_SSP=y
# BR2_UCLIBC_INSTALL_UTILS is not set
BR2_BINUTILS_VERSION_2_32_X=y
BR2_GCC_VERSION_9_X=y
BR2_TOOLCHAIN_BUILDROOT_CXX=y
BR2_GCC_ENABLE_LTO=y
BR2_GCC_ENABLE_GRAPHITE=y
BR2_PACKAGE_HOST_GDB=y
BR2_PACKAGE_HOST_GDB_TUI=y
BR2_GDB_VERSION_8_3=y
BR2_TARGET_GENERIC_HOSTNAME="hi35xx"
BR2_TARGET_GENERIC_ISSUE="Welcome to hi35xx-buildroot"
BR2_ROOTFS_DEVICE_CREATION_DYNAMIC_EUDEV=y
BR2_ROOTFS_OVERLAY="board/hisilicon/hi3518/fs-overlay"
BR2_LINUX_KERNEL=y
BR2_LINUX_KERNEL_CUSTOM_LOCAL=y
BR2_LINUX_KERNEL_CUSTOM_LOCAL_PATH="linux/linux-3.4.y"
BR2_LINUX_KERNEL_USE_CUSTOM_CONFIG=y
BR2_LINUX_KERNEL_CUSTOM_CONFIG_FILE="board/hisilicon/hi3518/linux-3.4.config"
BR2_LINUX_KERNEL_UIMAGE=y
BR2_LINUX_KERNEL_XZ=y
BR2_PACKAGE_BUSYBOX_CONFIG="board/hisilicon/hi3518/busybox.config"
BR2_PACKAGE_LIVE_STREAMER=y
BR2_PACKAGE_BITSTREAM_VERA=y
BR2_PACKAGE_HIMPP=y
BR2_PACKAGE_HIMPP_HI3518V200=y
BR2_PACKAGE_UBOOT_TOOLS=y
BR2_PACKAGE_LUAJIT=y
BR2_PACKAGE_LUA_PERIPHERY=y
BR2_PACKAGE_SIMPLEDBUS=y
BR2_PACKAGE_JSONCPP=y
BR2_TARGET_ROOTFS_SQUASHFS=y
BR2_TARGET_ROOTFS_SQUASHFS4_XZ=y
BR2_TARGET_ROOTFS_TAR_XZ=y
BR2_TARGET_UBOOT=y
BR2_TARGET_UBOOT_BOARDNAME="hi3518ev200"
BR2_TARGET_UBOOT_CUSTOM_LOCAL=y
BR2_TARGET_UBOOT_CUSTOM_LOCAL_PATH="boot/uboot/u-boot-2010.06"
BR2_TARGET_UBOOT_HI35XX_IMAGE=y
BR2_TARGET_UBOOT_HI35XX_IMAGE_CH_FILE="board/hisilicon/hi3518/boot/reg_info_hi3518ev200.bin"
BR2_TARGET_UBOOT_ENVIMAGE=y
BR2_TARGET_UBOOT_ENVIMAGE_SOURCE="board/hisilicon/hi3518/uboot-env.txt"
BR2_TARGET_UBOOT_ENVIMAGE_SIZE="0x40000"
```

## configs/hi3520_defconfig
```kconfig
BR2_arm=y
BR2_cortex_a9=y
BR2_ENABLE_DEBUG=y
BR2_KERNEL_HEADERS_VERSION=y
BR2_DEFAULT_KERNEL_VERSION="3.0.8"
BR2_PACKAGE_HOST_LINUX_HEADERS_CUSTOM_3_0=y
BR2_TOOLCHAIN_BUILDROOT_INET_RPC=y
BR2_TOOLCHAIN_BUILDROOT_WCHAR=y
BR2_PTHREAD_DEBUG=y
BR2_TOOLCHAIN_BUILDROOT_USE_SSP=y
# BR2_UCLIBC_INSTALL_UTILS is not set
BR2_GCC_VERSION_5_X=y
BR2_TOOLCHAIN_BUILDROOT_CXX=y
BR2_GCC_ENABLE_LTO=y
BR2_GCC_ENABLE_GRAPHITE=y
BR2_PACKAGE_HOST_GDB=y
BR2_PACKAGE_HOST_GDB_TUI=y
BR2_GDB_VERSION_7_10=y
BR2_TARGET_GENERIC_HOSTNAME="ipcam"
BR2_TARGET_GENERIC_ISSUE="Welcome to hi35xx-buildroot"
BR2_ROOTFS_DEVICE_CREATION_DYNAMIC_EUDEV=y
# BR2_TARGET_GENERIC_REMOUNT_ROOTFS_RW is not set
BR2_ROOTFS_OVERLAY="board/hisilicon/hi3520/fs-overlay"
BR2_LINUX_KERNEL=y
BR2_LINUX_KERNEL_CUSTOM_LOCAL=y
BR2_LINUX_KERNEL_CUSTOM_LOCAL_PATH="linux/linux-3.0.y"
BR2_LINUX_KERNEL_USE_CUSTOM_CONFIG=y
BR2_LINUX_KERNEL_CUSTOM_CONFIG_FILE="board/hisilicon/hi3520/linux-3.0.config"
BR2_LINUX_KERNEL_LZMA=y
BR2_PACKAGE_BUSYBOX_CONFIG="board/hisilicon/hi3520/busybox.config"
BR2_PACKAGE_LIVE_STREAMER=y
BR2_PACKAGE_HIMPP=y
BR2_PACKAGE_HIMPP_HI3520=y
BR2_PACKAGE_HIMPP_EXTDRV_GPIO_I2C=y
BR2_PACKAGE_HIMPP_EXTDRV_SIL9022=y
BR2_PACKAGE_HIMPP_EXTDRV_SSP_GV7601=y
BR2_PACKAGE_HIMPP_EXTDRV_TLV320AIC31=y
BR2_PACKAGE_UBOOT_TOOLS=y
BR2_TARGET_ROOTFS_SQUASHFS=y
BR2_TARGET_ROOTFS_SQUASHFS4_XZ=y
BR2_TARGET_ROOTFS_TAR_XZ=y
BR2_TARGET_UBOOT=y
BR2_TARGET_UBOOT_BOARDNAME="godcare"
BR2_TARGET_UBOOT_CUSTOM_LOCAL=y
BR2_TARGET_UBOOT_CUSTOM_LOCAL_PATH="boot/uboot/u-boot-2010.06"
BR2_TARGET_UBOOT_HI35XX_IMAGE=y
BR2_TARGET_UBOOT_HI35XX_IMAGE_CONFIG="board/hisilicon/hi3520/boot/reg_info_Hi3520A_930_310_620_ddr.bin"
BR2_TARGET_UBOOT_ENVIMAGE=y
BR2_TARGET_UBOOT_ENVIMAGE_SOURCE="board/hisilicon/hi3520/uboot-env.txt"
BR2_TARGET_UBOOT_ENVIMAGE_SIZE="0x40000"
```

## linux/linux-3.0.y/arch/arm/mach-godarm/Kconfig
```kconfig
menu "godarm board feature"

config MACH_GODARM
	bool "Support godarm platform"
	select CPU_V7
	select ARM_GIC
	help
	  Include support for the hisilion godarm(hi3521) platform.

config DEFAULT_BUSCLK
	int "DEFAULT_BUSCLK"
	default "50000000"
	help
	  Default AHB clock rate

endmenu
```

## linux/linux-3.0.y/arch/arm/mach-godbox-v1/Kconfig
```kconfig
menu "GODBOX V1 board feature"
config MACH_GODBOX_V1
	bool "Support godbox v1 platform"
	select CPU_V7
	select ARM_GIC
	help
	  Include support for the hisilion godbox v1 platform.

config DEFAULT_BUSCLK
	int "DEFAULT_BUSCLK"
	default "50000000"
	help
	Default AHB clock rate
endmenu
```

## linux/linux-3.0.y/arch/arm/mach-godbox/Kconfig
```kconfig
menu "GODBOX board feature"

config MACH_GODBOX
	bool "Support godbox platform"
	select CPU_V7
	select ARM_GIC
	help
	  Include support for the hisilion GODBOX platform.
	  GODBOX support ARM CORTEX-A9 processer,
	  within a Generic Interrupt Controller.
	  Support DDR2 and DDR3.

config DEFAULT_BUSCLK
	int "DEFAULT_BUSCLK"
	default "50000000"
	help
      	Default AHB clock rate

endmenu
```

## linux/linux-3.0.y/arch/arm/mach-godcube/Kconfig
```kconfig
menu "Godcube board feature"

config MACH_GODCUBE
	bool "Support Godcube platform"
	select CPU_ARM926T
	help
	  Include support for the hisilion godcube(hi3532) platform.

	  This includes specific configurations for the module and
	  its peripherals.

config DEFAULT_BUSCLK
	int "DEFAULT_BUSCLK"
	default "50000000"
	help
	  Default AHB clock rate

endmenu
```

## linux/linux-3.0.y/arch/arm/mach-godnet/Kconfig
```kconfig
menu "Godnet board feature"

config MACH_GODNET
	bool "Support Godnet platform"
	select CPU_V7
	select ARM_GIC
	help
	  Include support for the hisilion godnet(hi3531) platform.

config DEFAULT_BUSCLK
	int "DEFAULT_BUSCLK"
	default "50000000"
	help
	  Default AHB clock rate

endmenu
```

## linux/linux-3.0.y/arch/arm/mach-hi3518/Kconfig
```kconfig
menu "Hi3518 board feature"

config MACH_HI3518
	bool "Support Hi3518 platform"
	select CPU_ARM926T
	help
	  Includes support for the hisilion hi3518 platform.

	  This includes specific configurations for the module and
	  its peripherals.

config DEFAULT_BUSCLK
	int "DEFAULT_BUSCLK"
	default "50000000"
	help
	  Default AHB clock rate

endmenu
```

## linux/linux-3.0.y/arch/arm/mach-hi3520d/Kconfig
```kconfig
menu "hi3520d board feature"

config MACH_HI3520D
	bool "Support hi3520d platform"
	select CPU_V7
	select ARM_GIC
	help
	  Include support for the hisilion hi3520d platform.

config DEFAULT_BUSCLK
	int "DEFAULT_BUSCLK"
	default "50000000"
	help
	  Default AHB clock rate

endmenu
```

## linux/linux-3.0.y/arch/arm/mach-phoenix/Kconfig
```kconfig
menu "phoenix board feature"

config MACH_PHOENIX
	bool "Support phoenix platform"
	select CPU_V7
	select ARM_GIC
	help
	  Include support for the hisilion phoenix(x11) platform.
	  phoenix is ARM A9 Dual-CORE with L2cache,with NOEN, it is
	  design for smart TV/STB. phoenix support smp, android os
	  framwork.

config DEFAULT_BUSCLK
	int "DEFAULT_BUSCLK"
	default "50000000"
	help
	  Default AHB clock rate

endmenu
```

## linux/linux-3.0.y/drivers/ata/Kconfig.ahci
```kconfig
#
# hisatav100 sata ahci device configuration
#

menuconfig HI_SATA
	bool "hisilicon sata device support"
	depends on (ARCH_GODBOX_V1 || ARCH_GODBOX || ARCH_GODNET || ARCH_GODARM || ARCH_HI3520D)
	default y if (ARCH_GODBOX_V1 || ARCH_GODBOX  || ARCH_GODNET || ARCH_GODARM || ARCH_HI3520D)
	select ATA
	select ATA_VERBOSE_ERROR
	select SATA_PMP
#	select SATA_AHCI_PLATFORM
	help
	  This selects the hisilicon sata device.

if HI_SATA


config HI_SATA_IOBASE
	hex "hi sata IO address"
	default "0x60040000" if ARCH_GODBOX_V1
	default "0x60040000" if ARCH_GODBOX
	default "0x10080000" if (ARCH_GODNET || ARCH_GODARM || ARCH_HI3520D)

config HI_SATA_IOSIZE
	hex "hi sata IO size"
	default "0x00010000"
	help
	  default is 0x10000.

config HI_SATA_IRQNUM
	int "hi sata irq number"
	default "92" if ARCH_GODBOX_V1
	default "92" if ARCH_GODBOX
	default "68" if (ARCH_GODNET || ARCH_GODARM)
	default "52" if ARCH_HI3520D

config HI_SATA_PHY_CONFIG
	hex "hi sata phy config for 1.5G"
	default "0x0e262734" if (ARCH_GODBOX_V1 || ARCH_GODBOX)
	default "0x0e262709" if (ARCH_GODNET || ARCH_GODARM)
	default "0x0e276756" if (ARCH_HI3520D)
	help
	   default is 0x0e262709 when godnet and godarm.
	   default is 0x0e276756 when hi3520d.

config HI_SATA_PHYX_CTLH_VAL
	hex "hi sata phy[0/1] ctlh value"
	default "0x2121" if (ARCH_GODNET || ARCH_GODARM \
		|| ARCH_GODBOX_V1 || ARCH_GODBOX)
	default "0x2521" if (ARCH_HI3520D)
	help
	   default is 0x2121 when godnet and godarm.
	   default is 0x2521 when hi3520d.

config HI_SATA_PHY0_CTLL_3G_VAL
	hex "hi sata phy0 global ctrl low val"
	default "0x8a0ec888" if (ARCH_GODNET || ARCH_GODARM)
	default "0x880ec888" if ARCH_HI3520D

config HI_SATA_PHY0_CTLL_15G_VAL
	hex "hi sata phy0 global ctrl low val"
	default "0x8a0ec788" if (ARCH_GODNET || ARCH_GODARM)
	default "0x880ec788" if ARCH_HI3520D

config HI_SATA_3G_PHY_CONFIG
	hex "hi sata phy config for 3G"
	default "0x0e662753" if (ARCH_GODBOX_V1 || ARCH_GODBOX)
	default "0x0e662709" if (ARCH_GODNET || ARCH_GODARM)
	default "0x0e676756" if (ARCH_HI3520D)
	help
	   default is 0x0e662709 when godnet and godarm.
	   default is 0x0e676756 when hi3520d.

config HI_SATA_MODE
	int "hi sata interworking speed mode(1.5G:0/3G:1)"
	range 0 1
	default "0" if ARCH_GODBOX_V1
	default "0" if ARCH_GODBOX
	default "0" if (ARCH_GODNET || ARCH_GODARM || ARCH_HI3520D)

config HI_SATA_PORTS
	int "hi sata port number"
	default "2" if ARCH_GODBOX_V1
	default "1" if ARCH_GODBOX
	default "2" if (ARCH_GODNET || ARCH_GODARM || ARCH_HI3520D)

endif # HI_SATA

#vim: set ts=8 sw=8 tw=78:
```

## linux/linux-3.0.y/drivers/cpufreq/Kconfig.hifreq
```kconfig
#
# Hisilicon CPU frequency Drivers
#

config HI3518_CPUFREQ
	tristate "Hi3518-SOC CPU frequency Drivers"
	depends on CPU_FREQ
	help
	  Hisilicon Hi3518-SOCCPU frequency Drivers Support
```

## linux/linux-3.0.y/drivers/mmc/host/himciv100/Kconfig
```kconfig
#
#  himciv100 family SD/MMC device configuration
#

menuconfig HIMCIV100
	tristate "himciv100 sd/mmc device support"
	depends on (ARCH_GODEYES || ARCH_GODBOX || ARCH_GODNET || ARCH_PHOENIX || ARCH_GODARM || ARCH_HI3518)
	default y if (ARCH_GODEYES || ARCH_GODBOX || ARCH_GODNET || ARCH_PHOENIX || ARCH_GODARM || ARCH_HI3518)
	select MMC_UNSAFE_RESUME
	select MMC_EMBEDDED_SDIO
	select MMC_BLOCK
	select MMC_BLOCK_BOUNCE
	help
	  This selects the Hisilicon Synopsys MultiMedia Card Interface
	  support. If you have a mmc platform with a MultiMedia Card slot,
	  Say Y or M here.

	  default is Y.

if HIMCIV100

config HIMCI_IOBASE
	hex "himci reg base"
	default "0x10020000" if ARCH_GODEYES
	default "0x601C0000" if ARCH_GODBOX
	default "0x10020000" if (ARCH_GODNET || ARCH_GODARM)
	default "0x20070000" if ARCH_PHOENIX
	default "0x10020000" if ARCH_HI3518

config HIMCI_INTR
	int "himci intr number"
	default "70" if ARCH_GODEYES
	default "98" if ARCH_GODBOX
	default "67" if (ARCH_GODNET || ARCH_GODARM)
	default "73" if ARCH_PHOENIX
	default "18" if ARCH_HI3518

config MMC_CLK
	int "himci mmc clock"
	default "24000000" if ARCH_GODEYES
	default "24000000" if ARCH_GODBOX
	default "50000000" if (ARCH_GODNET || ARCH_GODARM)
	default "24000000" if ARCH_PHOENIX
	default "50000000" if ARCH_HI3518

config MMC_CCLK_MAX
	int "himci mmc c-clock max"
	default "12000000" if ARCH_GODEYES
	default "12000000" if ARCH_GODBOX
	default "12500000" if (ARCH_GODNET || ARCH_GODARM)
	default "12000000" if ARCH_PHOENIX
	default "50000000" if ARCH_HI3518

config MMC_CCLK_MIN
	int "himci mmc c-clock min"
	default "60000"

endif
```
