## linux/linux-3.0.y/drivers/net/stmmac/Kconfig
```kconfig
config STMMAC_ETH
	tristate "STMicroelectronics 10/100/1000 Ethernet driver"
	select MII
	select PHYLIB
	select CRC32
	depends on NETDEVICES && HAS_IOMEM && (ARCH_GODNET || ARCH_GODARM)
	help
	  This is the driver for the Ethernet IPs are built around a
	  Synopsys IP Core and only tested on the STMicroelectronics
	  platforms.

if STMMAC_ETH

config STMMAC_DA
	bool "STMMAC DMA arbitration scheme"
	default n
	help
	  Selecting this option, rx has priority over Tx (only for Giga
	  Ethernet device).
	  By default, the DMA arbitration scheme is based on Round-robin
	  (rx:tx priority is 1:1).

config STMMAC_DUAL_MAC
	bool "STMMAC: dual mac support"
	default n if GODARM
	default Y if GODNET
        depends on STMMAC_ETH
	help
	  The Huawei Hi3521 soCs has only one Ethernet Controllers.
	  The Huawei Hi35XX SoCs may have two Ethernet Controllers. This option turns on
	  the second Ethernet device if required.

config STMMAC_TIMER
	bool "STMMAC Timer optimisation"
	default n
	depends on RTC_HCTOSYS_DEVICE
	help
	  Use an external timer for mitigating the number of network
	  interrupts. Currently, for SH architectures, it is possible
	  to use the TMU channel 2 and the SH-RTC device.

choice
        prompt "Select Timer device"
        depends on STMMAC_TIMER

config STMMAC_TMU_TIMER
        bool "TMU channel 2"
        depends on CPU_SH4
	help

config STMMAC_RTC_TIMER
        bool "Real time clock"
        depends on RTC_CLASS
	help

endchoice

config STMMAC_IOADDR
	hex "STMMAC IO address"
	default "0x101c0000" if (ARCH_GODNET || ARCH_GODARM)

config STMMAC_IOSIZE
	hex "STMMAC IO size"
	default "0x00020000"

config STMMAC_IRQNUM
	int "STMMAC irq number"
	default "119" if (ARCH_GODNET || ARCH_GODARM)

config STMMAC_SYS_IOADDR
	hex "STMMAC System Config IO address"
	default "0x20030000" if (ARCH_GODNET || ARCH_GODARM)

config STMMAC_SYS_IOSIZE
	hex "STMMAC System Config IO size"
	default "0x00000100"

config STMMAC_PHY0_ID
	hex "STMMAC MAC #0 PHY ID"
	default 1 if (ARCH_GODNET || ARCH_GODARM)

config STMMAC_PHY1_ID
	hex "STMMAC MAC #1 PHY ID"
	default 2 if ARCH_GODNET
	depends on STMMAC_DUAL_MAC

endif
```

## linux/linux-3.0.y/drivers/usb/host/Kconfig.hiusb
```kconfig
#
# hiusb Host Controller Drivers
#
comment "hiusb Host Controller Drivers"
	depends on USB

menuconfig HIUSB_HOST
	bool "hiusb(ehci/ohci) family usb host device support"
	depends on (ARCH_GODBOX_V1)||(ARCH_GODEYES)||(ARCH_GODBOX)||(ARCH_GODNET)||(ARCH_PHOENIX)||(ARCH_GODARM)||(ARCH_HI3518 || ARCH_HI3520D)
	default y if (ARCH_GODBOX_V1)||(ARCH_GODEYES)||(ARCH_GODBOX)||(ARCH_GODNET)||(ARCH_PHOENIX)||(ARCH_GODARM)||(ARCH_HI3518 || ARCH_HI3520D)
	select USB
	select USB_ARCH_HAS_EHCI
#	select USB_EHCI_HCD
	select USB_ARCH_HAS_OHCI
#	select USB_OHCI_HCD
	help
	  This selects the usb(ehci/ohci) family usb host device.

if HIUSB_HOST

config HIUSB_EHCI
	bool "hiusb-ehci usb host device support"
	depends on (ARCH_GODBOX_V1)||(ARCH_GODEYES)||(ARCH_GODBOX)||(ARCH_GODNET)||(ARCH_PHOENIX)||(ARCH_GODARM)||(ARCH_HI3518 || ARCH_HI3520D)
	default y if (ARCH_GODBOX_V1)||(ARCH_GODEYES)||(ARCH_GODBOX)||(ARCH_GODNET)||(ARCH_PHOENIX)||(ARCH_GODARM)||(ARCH_HI3518 || ARCH_HI3520D)

config HIUSB_EHCI_IOBASE
	hex "hiusb-ehci IO address"
	default "0x60080000" if ARCH_GODBOX_V1
	default "0x100b0000" if ARCH_GODEYES
	default "0x60080000" if ARCH_GODBOX
	default "0x100b0000" if (ARCH_GODNET || ARCH_GODARM || ARCH_HI3518 || ARCH_HI3520D)
	default "0x20110000" if ARCH_PHOENIX

config HIUSB_EHCI_IOSIZE
	hex "hiusb-ehci IO size"
	default "0x00010000"
	help
	  default is 0x10000.

config HIUSB_EHCI_IRQNUM
	int "hiusb-ehci irq number"
	default "96" if ARCH_GODBOX_V1
	default "96" if ARCH_GODBOX
	default "68" if ARCH_GODEYES
	default "63" if (ARCH_GODNET || ARCH_GODARM)
	default "15" if ARCH_HI3518
	default "74" if ARCH_PHOENIX
	default "53" if ARCH_HI3520D

config HIUSB_OHCI
	bool "hiusb-ohci usb host device support"
	depends on (ARCH_GODBOX_V1)||(ARCH_GODEYES)||(ARCH_GODBOX)||(ARCH_GODNET)||(ARCH_PHOENIX)||(ARCH_GODARM)||(ARCH_HI3518)||(ARCH_HI3520D)
	default y if (ARCH_GODBOX_V1)||(ARCH_GODEYES)||(ARCH_GODBOX)||(ARCH_GODNET)||(ARCH_PHOENIX)||(ARCH_GODARM)||(ARCH_HI3518)||(ARCH_HI3520D)

config HIUSB_OHCI_IOBASE
	hex "hiusb-ohci IO address"
	default "0x60070000" if ARCH_GODBOX_V1
	default "0x100a0000" if ARCH_GODEYES
	default "0x60070000" if ARCH_GODBOX
	default "0x100a0000" if (ARCH_GODNET || ARCH_GODARM || ARCH_HI3518 || ARCH_HI3520D)
	default "0x20100000" if ARCH_PHOENIX

config HIUSB_OHCI_IOSIZE
	hex "hiusb-ohci IO size"
	default "0x00010000"
	help
	  default is 0x10000.

config HIUSB_OHCI_IRQNUM
	int "hiusb-ohci irq number"
	default "97" if ARCH_GODBOX_V1
	default "97" if ARCH_GODBOX
	default "69" if ARCH_GODEYES
	default "64" if (ARCH_GODNET || ARCH_GODARM)
	default "16" if ARCH_HI3518
	default "75" if ARCH_PHOENIX
	default "54" if ARCH_HI3520D

endif # HIUSB_HOST

#vim: set ts=8 sw=8 tw=78:
```

## linux/linux-3.18.y/Documentation/devicetree/bindings/i2c/i2c-hibvt.txt
```
Hisilicon BVT I2C master controller

Required properties:
- compatible: should be "hisilicon,hibvt-i2c" and one of the following:
	"hisilicon,hi3516cv300-i2c"
- reg: physical base address of the controller and length of memory mapped.
     region.
- interrupts: interrupt number to the cpu.
- clocks: phandles to input clocks.

Optional properties:
- clock-frequency: Desired I2C bus frequency in Hz, otherwise defaults to 100000.

Other properties:
see Documentation/devicetree/bindings/i2c/i2c.txt.

Examples:
i2c_bus0: i2c@12110000 {
	compatible = "hisilicon,hi3516cv300-i2c", "hisilicon,hibvt-i2c";
	reg = <0x12110000 0x100>;
	interrupts = <20>;
	clocks = <&crg_ctrl HI3516CV300_APB_CLK>;
	clock-frequency = <100000>;
};
```
