## linux/linux-3.0.y/drivers/mtd/devices/hisfc300/Kconfig
```kconfig
#
# hisilicon spi flash controller device version 300
#

menuconfig MTD_HISFC300
	tristate "hisilicon spi flash controller device version 300 driver"
	depends on (ARCH_GODBOX || ARCH_GODEYES || ARCH_GODNET || ARCH_GODCUBE)
	default y if (ARCH_GODBOX || ARCH_GODEYES || ARCH_GODNET || ARCH_GODCUBE)
	select MTD_SPI_IDS
	help
	  hisilicon spi flash controller device version 300.

	  if you have a spi flash, select Y or M.
	  default is Y.

if MTD_HISFC300

config HISFC300_BUFFER_BASE_ADDRESS
	hex "hisfc300 read/write memory base address"
	default "0x26000000" if ARCH_GODBOX
	default "0x58000000" if ARCH_GODEYES
	default "0x58000000" if ARCH_GODNET
	default "0x58000000" if ARCH_GODCUBE

config HISFC300_REG_BASE_ADDRESS
	hex "hisfc300 register base address"
	default "0x60020000" if ARCH_GODBOX
	default "0x10010000" if ARCH_GODEYES
	default "0x10010000" if ARCH_GODNET
	default "0x10010000" if ARCH_GODCUBE

config HISFC300_PERIPHERY_REGBASE
	hex "hisfc300 register base address"
	default "0x101F5000" if ARCH_GODBOX
	default "0x20030000" if ARCH_GODEYES
	default "0x20030000" if ARCH_GODNET
	default "0x20030000" if ARCH_GODCUBE

config HISFC300_CHIP_NUM
	int "hisfc300 spi chip number"
	default 2 if ARCH_GODBOX
	default 2 if ARCH_GODEYES
	default 2 if ARCH_GODNET
	default 2 if ARCH_GODCUBE

endif # MTD_HISFC300
```

## linux/linux-3.0.y/drivers/mtd/devices/hisfc300new/Kconfig
```kconfig
#
# hisilicon spi flash controller device version 300
#

menuconfig MTD_HISFC300NEW
	tristate "hisilicon spi flash controller device version 300new driver"
	depends on (ARCH_GODNET || ARCH_GODCUBE || ARCH_GODARM)
	default y if (ARCH_GODNET || ARCH_GODCUBE || ARCH_GODARM)
	select MTD_SPI_IDS
	help
	  hisilicon spi flash controller device version 300new.

	  if you have a spi flash, select Y or M.
	  default is Y.

if MTD_HISFC300NEW

config HISFC300NEW_BUFFER_BASE_ADDRESS
	hex "hisfc300new read/write memory base address"
	default "0x58000000" if (ARCH_GODNET || ARCH_GODARM || ARCH_GODCUBE)

config HISFC300NEW_REG_BASE_ADDRESS
	hex "hisfc300new register base address"
	default "0x10010000" if (ARCH_GODNET || ARCH_GODARM || ARCH_GODCUBE)

config HISFC300NEW_PERIPHERY_REGBASE
	hex "hisfc300new register base address"
	default "0x20030000" if (ARCH_GODNET || ARCH_GODARM || ARCH_GODCUBE)

config HISFC300NEW_CHIP_NUM
	int "hisfc300new spi chip number"
	default 2 if (ARCH_GODNET || ARCH_GODARM || ARCH_GODCUBE)

config HISFC300NEW_SHOW_CYCLE_TIMING
	bool "show spi read/write/erase timing cycle"
	default n
	help
	  Show spi read/write/erase timing cycle, command, clock.

endif # MTD_HISFC300NEW
```

## linux/linux-3.0.y/drivers/mtd/nand/hinfc300/Kconfig
```kconfig
#
# drivers/mtd/nand/hinfc300/Kconfig
#

menuconfig MTD_NAND_HINFC300
    tristate "Hisilicon NAND Controller v300 device Support"
    depends on MTD_NAND
    depends on (ARCH_GODBOX_V1)
    default y if (ARCH_GODBOX_V1)
    select MISC_FILESYSTEMS
    select MTD_BLOCK
    help
         Hisilicon NAND Controller v300 device Support

if MTD_NAND_HINFC300

config HINFC300_MAX_CHIP
    int "number of nand flash chip (1,2)"
    default 1
    help
      nand controller v300 device only support 1 or 2 nand flash chip,
      your should not config other value.

config HINFC300_DBG_NAND_PROC_FILE
    bool "debug: create /proc/nand file"
    help
      export /proc/nand file for debug.

config HINFC300_DBG_NAND_EC_NOTICE
    bool "debug: notice uncorrectable error"
    help
      notice nand uncorrectable error

choice
    prompt "Pagesize and Ecc Type Select"

config HINFC300_HARDWARE_PAGESIZE_ECC
    bool "Hardware"
    help
      pagesize and ecc type use hardware config

config HINFC300_AUTO_PAGESIZE_ECC
    bool "Auto"
    help
      pagesize and ecc type use hardware config

config HINFC300_PAGESIZE_AUTO_ECC_NONE
    bool "Pagesize Auto, Ecc None"
    help
      select pagesize 2K, ecc none.

endchoice

endif # MTD_NAND_HINFC300
```

## linux/linux-3.0.y/drivers/mtd/nand/hinfc301/Kconfig
```kconfig
#
# drivers/mtd/nand/hinfc301/Kconfig
#

menuconfig MTD_NAND_HINFC301
    tristate "Hisilicon NAND Controller v301 device Support"
    depends on MTD_NAND
    depends on (ARCH_GODEYES || ARCH_GODBOX || ARCH_GODNET || ARCH_PHOENIX || ARCH_GODARM || ARCH_HI3518)
    default y if (ARCH_GODEYES || ARCH_GODBOX || ARCH_GODNET || ARCH_PHOENIX || ARCH_GODARM || ARCH_HI3518)
    select MISC_FILESYSTEMS
    select MTD_BLOCK
    help
	 Hisilicon NAND Controller v301 device Support

	 Make sure the NAND Controller related I/O pins were
         pull up/down correctly.

if MTD_NAND_HINFC301

config HINFC301_REG_BASE_ADDRESS
	hex "nand controller's register base address"
	default 0x60010000 if (ARCH_GODBOX)
	default 0x10000000 if (ARCH_GODEYES || ARCH_GODNET || ARCH_GODARM || ARCH_HI3518)
	default 0x20010000 if (ARCH_PHOENIX)
	help
	  register base address of nand controller

	  this memory region include NFC_CMD NFC_STATUS
	  registers and so on.
          configure it in accord with the chip datasheet.

config HINFC301_BUFFER_BASE_ADDRESS
	hex "nand controller's buffer base address"
	default 0x24000000 if (ARCH_GODBOX)
	default 0x50000000 if (ARCH_GODEYES || ARCH_GODNET || ARCH_GODARM || ARCH_PHOENIX || ARCH_HI3518)
	help
	  buffer base address of nand controller

	  this buffer is the inner FIFO for nand
	  controller.
          configure it in accord with the chip datasheet.

config HINFC301_PERIPHERY_REGBASE
	hex "nand controller's peripher base address"
	default 0x101F5000 if (ARCH_GODBOX)
	default 0x20030000 if (ARCH_GODEYES || ARCH_GODNET || ARCH_GODARM || ARCH_HI3518)
	default 0x10021000 if (ARCH_PHOENIX)
	help
	  peripher base address of nand controller,for clk setting

	  peri_ctl_reg base addr, used for clk source select, clock
	  source enable, and controller reset.
          configure it in accord with the chip datasheet.

config HINFC301_W_LATCH
	hex "nand controller's write low pwidth"
	default "0x5" if (ARCH_GODBOX || ARCH_GODEYES ||ARCH_PHOENIX)
	default "0xa" if (ARCH_GODNET || ARCH_GODARM || ARCH_HI3518)
	help
		write pwidth is the low level of write sample in
		nand controller, which depend on the ahb clk.

config HINFC301_R_LATCH
	hex "nand controller's read low pwidth"
	default "0x5" if (ARCH_GODBOX || ARCH_GODEYES || ARCH_PHOENIX)
	default "0xa" if (ARCH_GODNET || ARCH_GODARM || ARCH_HI3518)
	help
		read pwidth is the low level of read sample in
		nand controller, which depend on the ahb clk.

config HINFC301_RW_LATCH
	hex "nand controller's read/write high pwidth"
	default "0x3" if (ARCH_GODBOX || ARCH_GODEYES || ARCH_PHOENIX)
	default "0xa" if (ARCH_GODNET || ARCH_GODARM || ARCH_HI3518)
	help
		read/write pwidth is the high level of read/write sample
		in nand controller, which depend on the ahb clk.

config HINFC301_MAX_CHIP
    int "number of nand flash chip (1,4)"
    default 1
    help
      nand controller v301 device only support 1 or 2 nand flash chip,
      your should not config other value.
      for a nand devices, chip nums = totoal size / chip size, you can
      get the chip size from the datasheet.

config HINFC301_DBG_NAND_PROC_FILE
    bool "debug: create /proc/nand file"
    help
      export /proc/nand file for debug.

      use /proc filesystem for debug purpuse.
      use /proc filesystem for debug purpuse.
      default is N.

config HINFC301_DBG_NAND_EC_NOTICE
    bool "debug: notice uncorrectable error"
    help
      notice nand uncorrectable error

      for debug purpuse
      default is N.

choice
    prompt "Pagesize and Ecc Type Select"

config HINFC301_HARDWARE_PAGESIZE_ECC
    bool "Hardware"
    help
      pagesize and ecc type use hardware config

      This is the default choice.
      drivers get the pagesize and ecc info from
      the pull up/down of specific I/O pins.

config HINFC301_AUTO_PAGESIZE_ECC
    bool "Auto"
    help
      pagesize and ecc type were choiced by driver.

      drivers read device ID, and get the pagesize
      info, then use best fit algorithms to decide
      the ecc type.

config HINFC301_PAGESIZE_AUTO_ECC_NONE
    bool "Pagesize Auto, Ecc None"
    help
      select pagesize 2K, ecc none.

      drivers get pagesize info from device ID, and
      don't use ecc.
      just for test purpose.

endchoice

endif # MTD_NAND_HINFC301
```

## linux/linux-3.0.y/drivers/net/hieth-sf/Kconfig
```kconfig
#
# hieth family network device configuration
#

menuconfig HIETH_SWITCH_FABRIC
	tristate "hieth(switch fabric) family network device support"
	depends on (ARCH_GODBOX_V1 || ARCH_GODVIEW || ARCH_GODBOX || ARCH_GODNET || ARCH_GODCUBE || ARCH_PHOENIX || ARCH_HI3518 || ARCH_HI3520D)
	default y if (ARCH_GODBOX_V1 || ARCH_GODVIEW || ARCH_GODBOX || ARCH_GODNET || ARCH_GODCUBE || ARCH_PHOENIX || ARCH_HI3518 || ARCH_HI3520D)
	select PHYLIB
	help
	  This selects the hieth family network device.

if HIETH_SWITCH_FABRIC

config HIETH_INNER_PHY
	bool "enable inner phy"
	depends on ARCH_HI3520D
	default n if ARCH_HI3520D
	help
	  Enable inner-phy in kernel.

config HIETH_TAG
	hex "hieth tag"
	default "0x726d6d73"
	help
	  This is graceful set mac in kernel.

config HIETH_IOBASE
	hex "hieth IO address"
	default "0x600D0000" if ARCH_GODBOX_V1
	default "0x10150000" if ARCH_GODVIEW
	default "0x600D0000" if ARCH_GODBOX
	default "0x10090000" if ARCH_GODNET
	default "0x10090000" if ARCH_GODCUBE
	default "0x20060000" if ARCH_PHOENIX
	default "0x10090000" if (ARCH_HI3518 || ARCH_HI3520D)

config HIETH_IOSIZE
	hex "hieth IO size"
	default "0x00010000"
	help
	  default is 0x10000.

config HIETH_IRQNUM
	int "hieth irq number"
	default "83" if ARCH_GODBOX_V1
	default "26" if ARCH_GODVIEW
	default "83" if ARCH_GODBOX
	default "58" if ARCH_GODNET
	default "12" if ARCH_GODCUBE
	default "38" if ARCH_PHOENIX
	default "12" if ARCH_HI3518
	default "56" if ARCH_HI3520D

config EEE_SUPPORT
	bool "eee support"
	depends on (ARCH_HI3518)
	default n if ARCH_HI3518
	help
	  default is disabled.

config HIETH_MONITOR_TIMER
	int "hieth monitor timer"
	default "10" if (ARCH_GODBOX_V1 || ARCH_GODVIEW || ARCH_GODBOX || ARCH_GODNET || ARCH_GODCUBE || ARCH_PHOENIX || ARCH_HI3518 || ARCH_HI3520D)
	help
	  hieth monitor timer, default is 10ms.

config HIETH_HWQ_XMIT_DEPTH
	int "hieth hardware queue send fifo depth"
	range 1 63
	default "12" if (ARCH_GODBOX_V1 || ARCH_GODVIEW || ARCH_GODBOX || ARCH_GODNET || ARCH_GODCUBE || ARCH_PHOENIX || ARCH_HI3518 || ARCH_HI3520D)
	help
	  This selects choice optimize RX or TX performance.
	  Default is 12(optimize RX performance).
	  If you need optimize TX performance, increase this factor maybe is good choice.

config HIETH_MDIO_FRQDIV
	int "hieth mdio frequency factor"
	default "2" if (ARCH_GODBOX_V1 || ARCH_GODVIEW || ARCH_GODBOX || ARCH_GODNET || ARCH_GODCUBE || ARCH_PHOENIX || ARCH_HI3518 || ARCH_HI3520D)

config HIETH_MII_RMII_MODE_U
	int "hieth mii/rmii mode for up port (mii:0/rmii:1)"
	range 0 1
	default "1" if (ARCH_GODBOX_V1 || ARCH_GODVIEW || ARCH_GODBOX || ARCH_GODNET || ARCH_PHOENIX)
	default "0" if (ARCH_GODCUBE || ARCH_HI3518 || ARCH_HI3520D)
	help
	  hieth mode as mii:0/rmii:1 for up port.

config HIETH_MII_RMII_MODE_D
	int "hieth mii/rmii mode for down port (mii:0/rmii:1)"
	range 0 1
	default "1"  if (ARCH_GODBOX_V1 || ARCH_GODVIEW || ARCH_GODBOX || ARCH_GODNET || ARCH_PHOENIX)
	default "0" if (ARCH_GODCUBE || ARCH_HI3518 || ARCH_HI3520D)
	help
	  hieth mode as mii:0/rmii:1 for down port.

config HIETH_PHYID_U
	int "hieth phyid for up port"
	range 0 31
	default "1"
	help
	  hieth phyid for up port.

config HIETH_PHYID_D
	int "hieth phyid for down port"
	range 0 31
	default "3"
	default "0" if (ARCH_GODNET || ARCH_GODCUBE)
	help
	  hieth phyid addr for down port.

config HIETH_DOWNPORT_EN
	bool "enable hieth down port"
	default y if (ARCH_GODNET || ARCH_GODCUBE || ARCH_GODBOX_V1 || ARCH_GODVIEW || ARCH_GODBOX || ARCH_PHOENIX)
	help
	  Hieth down port controller, to enable or disable down port.
	  If the eth controller support only one port, do not enable this option.
	  Otherwise some error information will appear during hieth init.

config HIETH_MAX_RX_POOLS
	int "hieth max rx pool size"
	default "1024"
	help
	  hieth max static rx pool size.

config HIETH_TRACE_LEVEL
	int "hieth trace(debug) level"
	range 0 18
	default "18"
	help
	  hieth trace(debug) level

config HIETH_RESET_HELPER_EN
	bool "hieth reset helper"
	default y
	default n if (ARCH_GODNET || ARCH_GODCUBE)
	help
	  hieth phy reset gpio helper.

config HIETH_RESET_HELPER_GPIO_BASE
	hex "hieth reset helper on which gpio group"
	depends on HIETH_RESET_HELPER_EN
	default "0x101EF000" if (ARCH_GODBOX_V1)
	default "0x101EF000" if (ARCH_GODBOX)
	default "0x20140000" if (ARCH_HI3518)
	default "0x201A0000" if (ARCH_HI3520D)
	help
	  hieth gpio group for reset.

config HIETH_RESET_HELPER_GPIO_BIT
	int "hieth reset helper on gpio bit"
	depends on HIETH_RESET_HELPER_EN
	range 0 7
	default "6" if (ARCH_GODBOX_V1)
	default "6" if (ARCH_GODBOX)
	default "5" if (ARCH_HI3518 || ARCH_HI3520D)
	help
	  hieth gpio group bit for reset.

config HIETH_RESET_HELPER_GPIO_VALUE
	int "hieth reset helper on gpio value"
	depends on HIETH_RESET_HELPER_EN
	range 0 1
	default "0" if (ARCH_GODBOX_V1)
	default "0" if (ARCH_GODBOX)
	default "0" if (ARCH_HI3518 || ARCH_HI3520D)
	help
	  hieth gpio reset value.

endif # HIETH_SWITCH_FABRIC

#vim: set ts=8 sw=8 tw=78:
```

## linux/linux-3.0.y/drivers/net/higmacv300/Kconfig
```kconfig
config HIGMACV300_ETH
	tristate "HigmacV300 Ethernet driver"
	select MII
	select PHYLIB
	select CRC32
	depends on NETDEVICES && HAS_IOMEM && ARCH_GODARM
	help
	  This is the driver for the Ethernet IPs are built around a
	  Synopsys IP Core and only tested on the STMicroelectronics
	  platforms.

if HIGMACV300_ETH

config HIGMACV300_DA
	bool "HIGMACV300 DMA arbitration scheme"
	default n
	help
	  Selecting this option, rx has priority over Tx (only for Giga
	  Ethernet device).
	  By default, the DMA arbitration scheme is based on Round-robin
	  (rx:tx priority is 1:1).

config HIGMACV300_DUAL_MAC
	bool "HIGMACiV300: dual mac support"
	default n
        depends on HIGMACV300_ETH
	help
	  The Huawei Hi3521 soCs has only one Ethernet Controllers.
	  The Huawei Hi35XX SoCs may have two Ethernet Controllers. This option turns on
	  the second Ethernet device if required.

config HIGMACV300_TIMER
	bool "HIGMACV300 Timer optimisation"
	default n
	depends on RTC_HCTOSYS_DEVICE
	help
	  Use an external timer for mitigating the number of network
	  interrupts. Currently, for SH architectures, it is possible
	  to use the TMU channel 2 and the SH-RTC device.

choice
        prompt "Select Timer device"
        depends on HIGMACV300_TIMER

config HIGMACV300_TMU_TIMER
        bool "TMU channel 2"
        depends on CPU_SH4
	help

config HIGMACV300_RTC_TIMER
        bool "Real time clock"
        depends on RTC_CLASS
	help

endchoice

config HIGMACV300_IOADDR
	hex "HIGMACV300 IO address"
	default "0x101c0000" if ARCH_GODARM

config HIGMACV300_IOSIZE
	hex "HIGMACV300 IO size"
	default "0x00020000"

config HIGMACV300_IRQNUM
	int "HIGMACV300 irq number"
	default "119" if ARCH_GODARM

config HIGMACV300_SYS_IOADDR
	hex "HIGMACV300 System Config IO address"
	default "0x20030000" if ARCH_GODARM

config HIGMACV300_SYS_IOSIZE
	hex "HIGMACV300 System Config IO size"
	default "0x00000100"

config HIGMACV300_PHY0_ID
	hex "HIGMACV300 MAC #0 PHY ID"
	default 1 if ARCH_GODARM

config HIGMACV300_PHY1_ID
	hex "HIGMACV300 MAC #1 PHY ID"
	default 2
	depends on HIGMACV300_DUAL_MAC

endif
```
